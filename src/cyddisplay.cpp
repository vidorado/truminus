#ifdef CYD
#include "cyddisplay.hpp"
#include <esp32_smartdisplay.h>
#include <WiFi.h>
#include "truminus-logo-transparent_rgb565.h"   // generated by scripts/gen_logo.py

// ═══════════════════════════════════════════════════════════════════════════
// Paleta
// ═══════════════════════════════════════════════════════════════════════════
#define C_BG         0x1a1a2e
#define C_TOPBAR     0x0f0f22
#define C_SEP        0x444466
#define C_LABEL      0x8888aa
#define C_BTN_OFF    0x2a2a4a
#define C_BTN_ON     0x3a7bd5
#define C_HEAT_ON    0x1a8a3a
#define C_TEXT       0xffffff
#define C_WIFI_OK    0x44ff44
#define C_WIFI_NO    0xff4444
#define C_WIFI_CONN  0xffaa00
#define C_MQTT_OK    0x44ffaa
#define C_MQTT_NO    0xff8800
#define C_MQTT_DIS   0x666688

// ═══════════════════════════════════════════════════════════════════════════
// Layout  (320×240 landscape)
// ═══════════════════════════════════════════════════════════════════════════
//  y=0..27   Barra superior (28px)
//  y=28      Separador horizontal
//  y=29..203 Contenido (175px)
//  y=204     Separador horizontal
//  y=205..239 Barra de estado (35px)
//
//  x=0..154  Panel izquierdo (155px)
//  x=155     Separador vertical
//  x=156..319 Panel derecho (164px)

#define Y_TOP_H   28
#define Y_SEP1    28
#define Y_CONT    29
#define Y_SEP2    204
#define Y_STAT    205
#define CONT_H    (Y_SEP2 - Y_CONT)   // 175

#define X_DIV     155
#define X_R       156
#define W_L       155
#define W_R       164

// ═══════════════════════════════════════════════════════════════════════════
// Valores de modos
// ═══════════════════════════════════════════════════════════════════════════
static const int   BOILER_N = 4;
static const char* BOILER_STR[BOILER_N] = {"off",  "eco", "high", "boost"};
static const char* BOILER_LAB[BOILER_N] = {"Apag.","Eco", "High", "Boost"};

static const int   FAN_N    = 3;
static const char* FAN_STR[FAN_N]  = {"eco", "high", "off"};
static const char* FAN_LAB[FAN_N]  = {"Eco", "Alto", "Apag."};

// ═══════════════════════════════════════════════════════════════════════════
// Punteros a settings
// ═══════════════════════════════════════════════════════════════════════════
static TTempSetting*   s_roomSp  = nullptr;
static TBoilerSetting* s_waterSp = nullptr;
static TOnOffSetting*  s_heatOn  = nullptr;
static TFanSetting*    s_fanMode = nullptr;

// ═══════════════════════════════════════════════════════════════════════════
// Handles de widgets
// ═══════════════════════════════════════════════════════════════════════════
static lv_obj_t* s_scr         = nullptr;

// Barra superior
static lv_obj_t* s_ambLbl      = nullptr;
static lv_obj_t* s_aguaLbl     = nullptr;
static lv_obj_t* s_wifiDot     = nullptr;
static lv_obj_t* s_mqttDot     = nullptr;
static lv_obj_t* s_linDot      = nullptr;

// Calefacción
static lv_obj_t* s_heatBtn     = nullptr;
static lv_obj_t* s_heatBtnLbl  = nullptr;
static lv_obj_t* s_spRow       = nullptr;   // fila setpoint
static lv_obj_t* s_spLbl       = nullptr;   // valor "22.0°C"

// Caldera y ventilador
static lv_obj_t* s_boilerBtn[BOILER_N];
static lv_obj_t* s_fanBtn[FAN_N];

// Estado
static lv_obj_t* s_statusLbl   = nullptr;
static lv_obj_t* s_ipLbl       = nullptr;

// ═══════════════════════════════════════════════════════════════════════════
// Logo — pixel buffer pre-convertido en tiempo de compilación (logo_rgb565.h)
// ═══════════════════════════════════════════════════════════════════════════
static uint16_t* s_logoBuf = nullptr; // heap copy para que LVGL pueda escribir

static void loadLogoToStatusBar(lv_obj_t* scr) {
    s_logoBuf = (uint16_t*)malloc(LOGO_W * LOGO_H * 2);
    if (!s_logoBuf) { Serial.println("[logo] OOM"); return; }
    memcpy(s_logoBuf, LOGO_RGB565, LOGO_W * LOGO_H * 2);

    lv_obj_t* canvas = lv_canvas_create(scr);
    lv_canvas_set_buffer(canvas, s_logoBuf, LOGO_W, LOGO_H,
                         LV_COLOR_FORMAT_RGB565);
    lv_obj_set_size(canvas, LOGO_W, LOGO_H);
    lv_obj_align(canvas, LV_ALIGN_BOTTOM_RIGHT, -2, -2);
    lv_obj_clear_flag(canvas, LV_OBJ_FLAG_CLICKABLE);

    Serial.printf("[logo] %dx%d px (%d bytes)\n", LOGO_W, LOGO_H, LOGO_W * LOGO_H * 2);
}

// ═══════════════════════════════════════════════════════════════════════════
// Helpers de construcción
// ═══════════════════════════════════════════════════════════════════════════
static lv_obj_t* makeBtn(lv_obj_t* parent,
                          int x, int y, int w, int h,
                          const char* txt,
                          lv_event_cb_t cb, void* udata = nullptr,
                          lv_obj_t** outLbl = nullptr) {
    lv_obj_t* btn = lv_btn_create(parent);
    lv_obj_set_pos(btn, x, y);
    lv_obj_set_size(btn, w, h);
    lv_obj_set_style_bg_color(btn, lv_color_hex(C_BTN_OFF), LV_PART_MAIN);
    lv_obj_set_style_bg_color(btn, lv_color_hex(C_BTN_ON),  LV_STATE_PRESSED);
    lv_obj_set_style_radius(btn, 5, LV_PART_MAIN);
    lv_obj_set_style_border_width(btn, 0, LV_PART_MAIN);
    lv_obj_set_style_shadow_width(btn, 0, LV_PART_MAIN);
    if (cb) lv_obj_add_event_cb(btn, cb, LV_EVENT_CLICKED, udata);

    lv_obj_t* lbl = lv_label_create(btn);
    lv_label_set_text(lbl, txt);
    lv_obj_set_style_text_color(lbl, lv_color_white(), LV_PART_MAIN);
    lv_obj_set_style_text_font(lbl, &lv_font_montserrat_14, LV_PART_MAIN);
    lv_obj_center(lbl);
    if (outLbl) *outLbl = lbl;
    return btn;
}

static void makeSep(lv_obj_t* parent, int x, int y, int w, int h) {
    lv_obj_t* sep = lv_obj_create(parent);
    lv_obj_remove_style_all(sep);
    lv_obj_set_pos(sep, x, y);
    lv_obj_set_size(sep, w, h);
    lv_obj_set_style_bg_color(sep, lv_color_hex(C_SEP), LV_PART_MAIN);
    lv_obj_set_style_bg_opa(sep, LV_OPA_COVER, LV_PART_MAIN);
    lv_obj_clear_flag(sep, (lv_obj_flag_t)(LV_OBJ_FLAG_CLICKABLE | LV_OBJ_FLAG_SCROLLABLE));
}

static lv_obj_t* makeSecLabel(lv_obj_t* parent, int x, int y, const char* txt) {
    lv_obj_t* lbl = lv_label_create(parent);
    lv_obj_set_style_text_font(lbl, &lv_font_montserrat_14, LV_PART_MAIN);
    lv_obj_set_style_text_color(lbl, lv_color_hex(C_LABEL), LV_PART_MAIN);
    lv_label_set_text(lbl, txt);
    lv_obj_set_pos(lbl, x, y);
    return lbl;
}

// ═══════════════════════════════════════════════════════════════════════════
// Refresco de controles (puede llamarse desde callbacks o desde update)
// ═══════════════════════════════════════════════════════════════════════════
static void refreshControls() {
    if (!s_heatOn || !s_roomSp || !s_waterSp || !s_fanMode) return;

    // ── Calefacción ──────────────────────────────────────────────────────
    bool heat = (s_heatOn->getIntValue() != 0);
    lv_label_set_text(s_heatBtnLbl, heat ? "ENCENDIDO" : "APAGADO");
    lv_obj_set_style_bg_color(s_heatBtn,
        lv_color_hex(heat ? C_HEAT_ON : C_BTN_OFF), LV_PART_MAIN);

    // ── Setpoint de temperatura ──────────────────────────────────────────
    if (heat) {
        lv_obj_remove_flag(s_spRow, LV_OBJ_FLAG_HIDDEN);
        char buf[12];
        snprintf(buf, sizeof(buf), "%.1f\xc2\xb0""C", s_roomSp->getFloatValue());
        lv_label_set_text(s_spLbl, buf);
    } else {
        lv_obj_add_flag(s_spRow, LV_OBJ_FLAG_HIDDEN);
    }

    // ── Caldera ──────────────────────────────────────────────────────────
    String boiler = s_waterSp->getStringValue();
    for (int i = 0; i < BOILER_N; i++) {
        lv_obj_set_style_bg_color(s_boilerBtn[i],
            lv_color_hex((boiler == BOILER_STR[i]) ? C_BTN_ON : C_BTN_OFF),
            LV_PART_MAIN);
    }

    // ── Ventilador ───────────────────────────────────────────────────────
    String fan = s_fanMode->getStringValue();
    for (int i = 0; i < FAN_N; i++) {
        lv_obj_set_style_bg_color(s_fanBtn[i],
            lv_color_hex((fan == FAN_STR[i]) ? C_BTN_ON : C_BTN_OFF),
            LV_PART_MAIN);
    }
}

// ═══════════════════════════════════════════════════════════════════════════
// Callbacks de botones
// ═══════════════════════════════════════════════════════════════════════════
static void heatCb(lv_event_t*) {
    if (!s_heatOn) return;
    s_heatOn->setValue(String(s_heatOn->getIntValue() ? "0" : "1"));
    refreshControls();
}

static void spDownCb(lv_event_t*) {
    if (!s_roomSp) return;
    double v = s_roomSp->getFloatValue() - 0.5;
    if (v >= 5.0) s_roomSp->setValue(v);
    refreshControls();
}

static void spUpCb(lv_event_t*) {
    if (!s_roomSp) return;
    double v = s_roomSp->getFloatValue() + 0.5;
    if (v <= 30.0) s_roomSp->setValue(v);
    refreshControls();
}

static void boilerCb(lv_event_t* e) {
    if (!s_waterSp) return;
    int idx = (int)(intptr_t)lv_event_get_user_data(e);
    s_waterSp->setValue(String(BOILER_STR[idx]));
    refreshControls();
}

static void fanCb(lv_event_t* e) {
    if (!s_fanMode) return;
    int idx = (int)(intptr_t)lv_event_get_user_data(e);
    s_fanMode->setValue(String(FAN_STR[idx]));
    refreshControls();
}

// ═══════════════════════════════════════════════════════════════════════════
// cydDisplayInit
// ═══════════════════════════════════════════════════════════════════════════
void cydDisplayInit(TTempSetting*   roomSetpoint,
                    TBoilerSetting* waterSetpoint,
                    TOnOffSetting*  heatingOn,
                    TFanSetting*    fanMode) {
    s_roomSp  = roomSetpoint;
    s_waterSp = waterSetpoint;
    s_heatOn  = heatingOn;
    s_fanMode = fanMode;

    // ── Pantalla ─────────────────────────────────────────────────────────
    s_scr = lv_obj_create(NULL);
    lv_obj_remove_style_all(s_scr);
    lv_obj_set_style_bg_color(s_scr, lv_color_hex(C_BG), LV_PART_MAIN);
    lv_obj_set_style_bg_opa(s_scr, LV_OPA_COVER, LV_PART_MAIN);
    lv_obj_clear_flag(s_scr, (lv_obj_flag_t)(LV_OBJ_FLAG_SCROLLABLE));
    lv_screen_load(s_scr);

    // ── Barra superior ───────────────────────────────────────────────────
    lv_obj_t* topBar = lv_obj_create(s_scr);
    lv_obj_remove_style_all(topBar);
    lv_obj_set_pos(topBar, 0, 0);
    lv_obj_set_size(topBar, 320, Y_TOP_H);
    lv_obj_set_style_bg_color(topBar, lv_color_hex(C_TOPBAR), LV_PART_MAIN);
    lv_obj_set_style_bg_opa(topBar, LV_OPA_COVER, LV_PART_MAIN);
    lv_obj_clear_flag(topBar, (lv_obj_flag_t)(LV_OBJ_FLAG_CLICKABLE | LV_OBJ_FLAG_SCROLLABLE));

    s_ambLbl = lv_label_create(topBar);
    lv_obj_set_style_text_font(s_ambLbl, &lv_font_montserrat_14, LV_PART_MAIN);
    lv_obj_set_style_text_color(s_ambLbl, lv_color_hex(0xaaccff), LV_PART_MAIN);
    lv_label_set_text(s_ambLbl, "Temp. amb.: -- \xc2\xb0""C");
    lv_obj_set_pos(s_ambLbl, 5, 7);

    s_aguaLbl = lv_label_create(topBar);
    lv_obj_set_style_text_font(s_aguaLbl, &lv_font_montserrat_14, LV_PART_MAIN);
    lv_obj_set_style_text_color(s_aguaLbl, lv_color_hex(0xaaccff), LV_PART_MAIN);
    lv_label_set_text(s_aguaLbl, "Agua: -- \xc2\xb0""C");
    lv_obj_set_pos(s_aguaLbl, 155, 7);

    // Iconos de estado WiFi / MQTT / LIN bus — tres iconos en la esquina superior derecha
    // WiFi: LV_SYMBOL_WIFI (icono nativo LVGL)
    // MQTT: LV_SYMBOL_UPLOAD (↑ no existe icono MQTT en LVGL; representa publicar al broker)
    // LIN:  "T" de Truma, coloreada según estado del bus
    auto makeStatusIcon = [&](int x, const char* sym, uint32_t col) -> lv_obj_t* {
        lv_obj_t* lbl = lv_label_create(topBar);
        lv_obj_set_style_text_font(lbl, &lv_font_montserrat_14, LV_PART_MAIN);
        lv_obj_set_style_text_color(lbl, lv_color_hex(col), LV_PART_MAIN);
        lv_label_set_text(lbl, sym);
        lv_obj_set_pos(lbl, x, 6);
        lv_obj_clear_flag(lbl, LV_OBJ_FLAG_CLICKABLE);
        return lbl;
    };
    s_wifiDot = makeStatusIcon(247, LV_SYMBOL_WIFI,   C_WIFI_NO);
    s_mqttDot = makeStatusIcon(272, LV_SYMBOL_UPLOAD, C_MQTT_DIS);
    s_linDot  = makeStatusIcon(300, "T",              C_WIFI_NO);

    // ── Separadores ──────────────────────────────────────────────────────
    makeSep(s_scr, 0,     Y_SEP1, 320, 1);   // horizontal top
    makeSep(s_scr, X_DIV, Y_CONT, 1, CONT_H); // vertical
    makeSep(s_scr, 0,     Y_SEP2, 320, 1);   // horizontal bottom

    // ── Panel izquierdo: Calefacción ─────────────────────────────────────
    makeSecLabel(s_scr, 4, Y_CONT + 2, "CALEFACCION");

    s_heatBtn = makeBtn(s_scr, 4, Y_CONT + 20, W_L - 8, 44,
                        "APAGADO", heatCb, nullptr, &s_heatBtnLbl);
    lv_obj_set_style_text_font(s_heatBtnLbl, &lv_font_montserrat_14, LV_PART_MAIN);

    // Fila de setpoint (oculta cuando calefacción OFF)
    s_spRow = lv_obj_create(s_scr);
    lv_obj_remove_style_all(s_spRow);
    lv_obj_set_pos(s_spRow, 4, Y_CONT + 70);
    lv_obj_set_size(s_spRow, W_L - 8, 36);
    lv_obj_set_style_bg_opa(s_spRow, LV_OPA_TRANSP, LV_PART_MAIN);
    lv_obj_clear_flag(s_spRow, (lv_obj_flag_t)(LV_OBJ_FLAG_CLICKABLE | LV_OBJ_FLAG_SCROLLABLE));
    lv_obj_add_flag(s_spRow, LV_OBJ_FLAG_HIDDEN);

    makeBtn(s_spRow,  0, 0, 36, 36, LV_SYMBOL_DOWN, spDownCb);

    s_spLbl = lv_label_create(s_spRow);
    lv_obj_set_style_text_font(s_spLbl, &lv_font_montserrat_20, LV_PART_MAIN);
    lv_obj_set_style_text_color(s_spLbl, lv_color_white(), LV_PART_MAIN);
    lv_obj_set_style_text_align(s_spLbl, LV_TEXT_ALIGN_CENTER, LV_PART_MAIN);
    lv_obj_set_size(s_spLbl, 71, 36);
    lv_obj_set_pos(s_spLbl, 39, 4);
    lv_label_set_text(s_spLbl, "20.0\xc2\xb0""C");

    makeBtn(s_spRow, W_L - 8 - 36, 0, 36, 36, LV_SYMBOL_UP, spUpCb);

    // ── Panel derecho: Caldera ────────────────────────────────────────────
    makeSecLabel(s_scr, X_R + 2, Y_CONT + 2, "CALDERA");

    // 4 botones en rejilla 2×2
    int bx[4] = {X_R + 2, X_R + 83, X_R + 2, X_R + 83};
    int by[4] = {Y_CONT + 20, Y_CONT + 20, Y_CONT + 54, Y_CONT + 54};
    for (int i = 0; i < BOILER_N; i++) {
        s_boilerBtn[i] = makeBtn(s_scr, bx[i], by[i], 79, 30,
                                  BOILER_LAB[i], boilerCb, (void*)(intptr_t)i);
    }

    // ── Panel derecho: Ventilador ─────────────────────────────────────────
    makeSecLabel(s_scr, X_R + 2, Y_CONT + 94, "VENTILADOR");

    int fx[3] = {X_R + 2, X_R + 57, X_R + 112};
    for (int i = 0; i < FAN_N; i++) {
        s_fanBtn[i] = makeBtn(s_scr, fx[i], Y_CONT + 114, 53, 30,
                               FAN_LAB[i], fanCb, (void*)(intptr_t)i);
    }

    // ── Barra de estado ───────────────────────────────────────────────────
    s_statusLbl = lv_label_create(s_scr);
    lv_obj_set_style_text_font(s_statusLbl, &lv_font_montserrat_14, LV_PART_MAIN);
    lv_obj_set_style_text_color(s_statusLbl, lv_color_hex(C_WIFI_OK), LV_PART_MAIN);
    lv_label_set_text(s_statusLbl, "Iniciando...");
    lv_obj_align(s_statusLbl, LV_ALIGN_BOTTOM_LEFT, 5, -18); // 2px lower than before

    s_ipLbl = lv_label_create(s_scr);
    lv_obj_set_style_text_font(s_ipLbl, &lv_font_montserrat_14, LV_PART_MAIN);
    lv_obj_set_style_text_color(s_ipLbl, lv_color_hex(0x88aaff), LV_PART_MAIN);
    lv_label_set_text(s_ipLbl, "");
    lv_obj_align(s_ipLbl, LV_ALIGN_BOTTOM_LEFT, 5, -2);      // 2px lower than before

    refreshControls();

    // Logo: bottom-right of the status bar
    loadLogoToStatusBar(s_scr);
}

// ═══════════════════════════════════════════════════════════════════════════
// cydDisplayUpdate  — llamar en cada iteración de loop()
// ═══════════════════════════════════════════════════════════════════════════
void cydDisplayUpdate(bool wifiok, bool mqttok, bool trumaok,
                      bool truma_reset, bool inota, bool mqttEnabled,
                      float roomTemp, float waterTemp) {
    // Si alguna pantalla de setup reemplazó s_scr, restaurarla.
    if (s_scr && lv_screen_active() != s_scr) {
        lv_screen_load(s_scr);
    }

    // ── Temperaturas barra superior ──────────────────────────────────────
    if (s_ambLbl) {
        char buf[26];
        if (trumaok && roomTemp > -200.0f)
            snprintf(buf, sizeof(buf), "Temp. amb.: %.1f \xc2\xb0""C", roomTemp);
        else
            strcpy(buf, "Temp. amb.: -- \xc2\xb0""C");
        lv_label_set_text(s_ambLbl, buf);
    }
    if (s_aguaLbl) {
        char buf[20];
        if (trumaok && waterTemp > -200.0f)
            snprintf(buf, sizeof(buf), "Agua: %.1f \xc2\xb0""C", waterTemp);
        else
            strcpy(buf, "Agua: -- \xc2\xb0""C");
        lv_label_set_text(s_aguaLbl, buf);
    }

    // ── Punto WiFi ───────────────────────────────────────────────────────
    static bool s_everConnected = false;
    if (wifiok) s_everConnected = true;

    if (s_wifiDot) {
        lv_color_t c = lv_color_hex(wifiok          ? C_WIFI_OK   :
                                     s_everConnected ? C_WIFI_NO   :
                                                       C_WIFI_CONN);
        lv_obj_set_style_text_color(s_wifiDot, c, LV_PART_MAIN);
    }

    // ── Icono MQTT ───────────────────────────────────────────────────────
    if (s_mqttDot) {
        lv_color_t c = lv_color_hex(!mqttEnabled ? C_MQTT_DIS :
                                     mqttok       ? C_MQTT_OK  : C_MQTT_NO);
        lv_obj_set_style_text_color(s_mqttDot, c, LV_PART_MAIN);
    }

    // ── Icono LIN bus (T de Truma) ────────────────────────────────────────
    if (s_linDot) {
        lv_obj_set_style_text_color(s_linDot,
            lv_color_hex(trumaok ? C_WIFI_OK : C_WIFI_NO), LV_PART_MAIN);
    }

    // ── IP ───────────────────────────────────────────────────────────────
    if (s_ipLbl) {
        lv_label_set_text(s_ipLbl, wifiok ? WiFi.localIP().toString().c_str() : "");
    }

    // ── Mensaje de estado ────────────────────────────────────────────────
    const char* msg   = "";
    uint32_t    msgC  = C_WIFI_OK;
    if (inota) {
        msg = "Actualizando firmware...";  msgC = 0xffd700;
    } else if (!wifiok) {
        if (WiFi.status() == WL_DISCONNECTED || WiFi.status() == WL_IDLE_STATUS) {
            msg = "Conectando WiFi...";    msgC = C_WIFI_CONN;
        } else {
            msg = "Sin WiFi";              msgC = C_WIFI_NO;
        }
    } else if (!mqttok && mqttEnabled) {
        msg = "Sin MQTT";                  msgC = C_MQTT_NO;
    } else if (!trumaok) {
        msg = "Sin LIN bus";               msgC = C_WIFI_NO;
    }

    if (s_statusLbl) {
        lv_label_set_text(s_statusLbl, msg);
        lv_obj_set_style_text_color(s_statusLbl, lv_color_hex(msgC), LV_PART_MAIN);
    }

    // ── Refresco de controles (pueden cambiar por MQTT externo) ──────────
    refreshControls();
}

#endif // CYD
