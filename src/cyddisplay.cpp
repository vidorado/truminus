#ifdef CYD
#include "cyddisplay.hpp"
#include "logs.hpp"
#include "i18n.hpp"
#include <esp32_smartdisplay.h>
#include <WiFi.h>
#include <Preferences.h>
#include "wifisetup.hpp"
#include "truminus-logo-transparent_rgb565.h"   // generated by scripts/gen_logo.py

// ── Extra FontAwesome symbols (generated by scripts/gen_symbols.ps1) ─────────
LV_FONT_DECLARE(symbols_14);
#define MY_SYMBOL_THERMOMETER "\xEF\x80\x95"   // U+F015  fa-home (room temperature)
#define MY_SYMBOL_TINT        "\xEF\x81\x83"   // U+F043  fa-tint
#define MY_SYMBOL_FIRE        "\xEF\x81\xAD"   // U+F06D  fa-fire (heating active)
#define MY_SYMBOL_THERM_EXT   "\xEF\x8B\x89"   // U+F2C9  fa-thermometer-half (outdoor temperature)
#define MY_SYMBOL_CHEVRON_R   "\xEF\x81\x94"   // U+F054  fa-chevron-right

// ═══════════════════════════════════════════════════════════════════════════
// Colour palette
// ═══════════════════════════════════════════════════════════════════════════
#define C_BG         0x1a1a2e
#define C_TOPBAR     0x0f0f22
#define C_SEP        0x444466
#define C_LABEL      0x8888aa
#define C_BTN_OFF    0x2a2a4a
#define C_BTN_ON     0x3a7bd5
#define C_HEAT_ON    0x1a8a3a
#define C_TEXT       0xffffff
#define C_WIFI_OK    0x44ff44
#define C_WIFI_NO    0xff4444
#define C_WIFI_CONN  0xffaa00
#define C_MQTT_OK    0x44ffaa
#define C_MQTT_NO    0xff8800
#define C_MQTT_DIS   0x666688
#define C_WARN       0xffaa00
#define C_ERR_LOCKED 0xcc2222

// ═══════════════════════════════════════════════════════════════════════════
// Layout  (320×240 landscape)
// ═══════════════════════════════════════════════════════════════════════════
#define Y_TOP_H   28
#define Y_SEP1    28
#define Y_CONT    29
#define Y_SEP2    204
#define Y_STAT    205
#define CONT_H    (Y_SEP2 - Y_CONT)   // 175

#define X_DIV     141          // vertical separator x (narrower heating panel)
#define X_R       142          // right panel start x
#define W_L       141          // left panel width
#define W_R       178          // right panel width

// ═══════════════════════════════════════════════════════════════════════════
// Mode value tables  (protocol strings, not displayed — no translation needed)
// ═══════════════════════════════════════════════════════════════════════════
static const int   BOILER_N = 4;
static const char* BOILER_STR[BOILER_N] = {"off", "eco", "high", "boost"};

static const int   FAN_N      = 3;
static const int   FAN_HEAT_N = 2;   // Eco/High only when heating is ON
static const char* FAN_STR[FAN_N]   = {"eco", "high", "off"};

// Timeout options — indexed by s_timeoutIdx
static const uint32_t TIMEOUT_MS[4]  = { 30000, 60000, 180000, 0 };
static const TK       TIMEOUT_TK[4]  = { TK::TIMEOUT_30S, TK::TIMEOUT_1M,
                                          TK::TIMEOUT_3M,  TK::TIMEOUT_NEVER };
static const int      TIMEOUT_N      = 4;

// ── Translated label helpers ──────────────────────────────────────────────

static const char* boilerLabel(int i) {
    switch (i) {
        case 0:  return t(TK::FAN_OFF);        // "Apag." / "Off."
        case 1:  return "40\xc2\xb0""C";
        case 2:  return "60\xc2\xb0""C";
        case 3:  return "60\xc2\xb0""C " LV_SYMBOL_CHARGE;
        default: return "";
    }
}

static const char* fanHeatLabel(int i) {
    switch (i) {
        case 0:  return t(TK::FAN_ECO);
        case 1:  return t(TK::FAN_HIGH);
        default: return "";
    }
}

// Build "SYMBOL text" in a shared static buffer (safe: LVGL copies the string).
static char s_symBuf[48];
static const char* symText(const char* sym, TK key) {
    snprintf(s_symBuf, sizeof(s_symBuf), "%s %s", sym, t(key));
    return s_symBuf;
}

// ═══════════════════════════════════════════════════════════════════════════
// Settings pointers
// ═══════════════════════════════════════════════════════════════════════════
static TTempSetting*   s_roomSp  = nullptr;
static TBoilerSetting* s_waterSp = nullptr;
static TOnOffSetting*  s_heatOn  = nullptr;
static TFanSetting*    s_fanMode = nullptr;

// ═══════════════════════════════════════════════════════════════════════════
// Internal state
// ═══════════════════════════════════════════════════════════════════════════
static int s_fanLevel   = 5;   // numeric fan level when heating is off (1-10)
static int s_energyMode = 0;   // active TEnergySelection index (0-4)

// ── Truma error state ──────────────────────────────────────────────────────
static uint8_t   s_lastErrClass = 0;
static uint8_t   s_lastErrCode  = 0;
static bool      s_errAcked     = false;
static lv_obj_t* s_errorModal   = nullptr;

// ═══════════════════════════════════════════════════════════════════════════
// Widget handles
// ═══════════════════════════════════════════════════════════════════════════
static lv_obj_t* s_scr          = nullptr;

// Top bar
static lv_obj_t* s_ambLbl       = nullptr;
static lv_obj_t* s_aguaLbl      = nullptr;
static lv_obj_t* s_fireLbl      = nullptr;   // flame icon — blinks when heating is active
static lv_obj_t* s_extLbl       = nullptr;   // outdoor temperature (AM2301)
static lv_obj_t* s_wifiDot      = nullptr;
static lv_obj_t* s_linDot       = nullptr;

// Left panel — Heating
static lv_obj_t* s_heatBtn      = nullptr;
static lv_obj_t* s_heatBtnLbl   = nullptr;
static lv_obj_t* s_spRow        = nullptr;   // setpoint row
static lv_obj_t* s_spLbl        = nullptr;   // value "22.0°C"

// Left panel — Fan
static lv_obj_t* s_fanHeatingRow = nullptr;  // eco/high row  (heating ON)
static lv_obj_t* s_fanOffRow     = nullptr;  // On/Off row    (heating OFF)
static lv_obj_t* s_fanLevelRow   = nullptr;  // ↓ level ↑ row (heating OFF + On)
static lv_obj_t* s_fanBtn[FAN_N];            // eco/high/off buttons
static lv_obj_t* s_fanOnBtn      = nullptr;
static lv_obj_t* s_fanOffBtn     = nullptr;
static lv_obj_t* s_fanLevelLbl   = nullptr;

// Right panel — Hot water + Energy
static lv_obj_t* s_boilerBtn[BOILER_N];
static lv_obj_t* s_energyDd      = nullptr;

// Right panel — Solar data (compact, no section label)
static lv_obj_t* s_solarStateLbl = nullptr;
static lv_obj_t* s_solarVoltLbl  = nullptr;
static lv_obj_t* s_solarLoadLbl  = nullptr;
static lv_obj_t* s_solarProdLbl  = nullptr;

// Right panel — Battery SOC (below solar data)
static lv_obj_t* s_battSocLbl = nullptr;
static lv_obj_t* s_battBody   = nullptr;
static lv_obj_t* s_battFill   = nullptr;
static int       s_battFillX  = 0;    // BB_X + 1, set in buildMainUI()
static lv_obj_t* s_battNub    = nullptr;   // left terminal
static lv_obj_t* s_battNub2   = nullptr;   // right terminal

// Right panel — Water temperature bar widget (battery-style, no nubs)
static lv_obj_t* s_waterTempLbl  = nullptr;
static lv_obj_t* s_waterTempBody = nullptr;  // border rect
static lv_obj_t* s_waterTempFill = nullptr;  // bottom-anchored fill
static int       s_waterTempFillX = 0;       // cached x pos

// Status bar
static lv_obj_t* s_statusLbl    = nullptr;
static lv_obj_t* s_ipLbl        = nullptr;

// ── Backlight fade (dedicated FreeRTOS task) ─────────────────────────────
// blFadeTo() is safe to call from any context; the task moves the current
// brightness toward the target at 0.04 per tick (20 ms) → 500 ms full fade.
static volatile float s_blCurrent = 1.0f;
static volatile float s_blTarget  = 1.0f;

static void blFadeTo(float target) { s_blTarget = target; }

static void backlightTask(void* /*arg*/) {
    const TickType_t TICK = pdMS_TO_TICKS(20);
    const float      STEP = 1.0f / 25.0f;
    for (;;) {
        float cur = s_blCurrent;
        float tgt = s_blTarget;
        if (cur != tgt) {
            float delta = tgt - cur;
            float step  = (delta >  0.0f) ? ((delta <  STEP) ? delta :  STEP)
                                           : ((delta > -STEP) ? delta : -STEP);
            cur += step;
            if (cur < 0.0f) cur = 0.0f;
            if (cur > 1.0f) cur = 1.0f;
            s_blCurrent = cur;
            smartdisplay_lcd_set_backlight(cur);
        }
        vTaskDelay(TICK);
    }
}

// ── Screen timeout / power-off state ─────────────────────────────────────
static volatile CydNavRequest s_navRequest = CydNavRequest::None;

static int       s_timeoutIdx   = 0;
static bool      s_screenOff    = false;
static bool      s_screenDimmed = false;
static lv_obj_t* s_wakeOverlay  = nullptr;
static lv_obj_t* s_settingsScr  = nullptr;
static lv_obj_t* s_displayScr   = nullptr;
static lv_obj_t* s_dispOptBtn[TIMEOUT_N] = {};

// Forward declarations (callbacks call each other mutually)
static void showSettingsMenu();
static void showDisplaySettings();

// ═══════════════════════════════════════════════════════════════════════════
// Logo
// ═══════════════════════════════════════════════════════════════════════════
static uint16_t* s_logoBuf = nullptr;

static void placeLogoInStatusBar(lv_obj_t* scr) {
    if (!s_logoBuf) return;
    lv_obj_t* canvas = lv_canvas_create(scr);
    lv_canvas_set_buffer(canvas, s_logoBuf, LOGO_W, LOGO_H,
                         LV_COLOR_FORMAT_RGB565);
    lv_obj_set_size(canvas, LOGO_W, LOGO_H);
    lv_obj_align(canvas, LV_ALIGN_BOTTOM_RIGHT, -2, -2);
    lv_obj_clear_flag(canvas, LV_OBJ_FLAG_CLICKABLE);
}

static void showSplash(uint32_t ms) {
    s_logoBuf = (uint16_t*)malloc(LOGO_W * LOGO_H * 2);
    if (!s_logoBuf) { LOG_LVGL_PL("[logo] OOM"); return; }
    memcpy(s_logoBuf, LOGO_RGB565, LOGO_W * LOGO_H * 2);

    lv_obj_t* splash = lv_obj_create(NULL);
    lv_obj_remove_style_all(splash);
    lv_obj_set_style_bg_color(splash, lv_color_hex(C_BG),  LV_PART_MAIN);
    lv_obj_set_style_bg_opa (splash, LV_OPA_COVER,         LV_PART_MAIN);
    lv_obj_clear_flag(splash, (lv_obj_flag_t)(LV_OBJ_FLAG_CLICKABLE | LV_OBJ_FLAG_SCROLLABLE));

    lv_obj_t* canvas = lv_canvas_create(splash);
    lv_canvas_set_buffer(canvas, s_logoBuf, LOGO_W, LOGO_H,
                         LV_COLOR_FORMAT_RGB565);
    lv_obj_set_size(canvas, LOGO_W, LOGO_H);
    lv_obj_align(canvas, LV_ALIGN_CENTER, 0, 0);
    lv_obj_clear_flag(canvas, LV_OBJ_FLAG_CLICKABLE);

    lv_screen_load(splash);

    uint32_t t0 = millis();
    uint32_t _last = millis();
    while (millis() - t0 < ms) {
        uint32_t _now = millis();
        lv_tick_inc(_now - _last);
        _last = _now;
        lv_task_handler(); delay(5);
    }

    // Load a blank screen and auto-delete splash — avoids deleting the active
    // screen while it is still the active screen, which leaves LVGL with a
    // dangling act_scr pointer and breaks the next lv_screen_load() call.
    lv_obj_t* blank = lv_obj_create(NULL);
    lv_screen_load_anim(blank, LV_SCR_LOAD_ANIM_NONE, 0, 0, /*auto_del=*/true);
    lv_tick_inc(5);
    lv_task_handler();   // commit the switch; splash is deleted here

    LOG_LVGL_PF("[logo] splash %dx%d px (%d bytes)\n", LOGO_W, LOGO_H, LOGO_W * LOGO_H * 2);
}

// ═══════════════════════════════════════════════════════════════════════════
// Builder helpers
// ═══════════════════════════════════════════════════════════════════════════
static lv_obj_t* makeBtn(lv_obj_t* parent,
                          int x, int y, int w, int h,
                          const char* txt,
                          lv_event_cb_t cb, void* udata = nullptr,
                          lv_obj_t** outLbl = nullptr) {
    lv_obj_t* btn = lv_btn_create(parent);
    lv_obj_set_pos(btn, x, y);
    lv_obj_set_size(btn, w, h);
    lv_obj_set_style_bg_color(btn, lv_color_hex(C_BTN_OFF), LV_PART_MAIN);
    lv_obj_set_style_bg_color(btn, lv_color_hex(C_BTN_ON),  LV_STATE_PRESSED);
    lv_obj_set_style_radius(btn, 5, LV_PART_MAIN);
    lv_obj_set_style_border_width(btn, 0, LV_PART_MAIN);
    lv_obj_set_style_shadow_width(btn, 0, LV_PART_MAIN);
    if (cb) lv_obj_add_event_cb(btn, cb, LV_EVENT_CLICKED, udata);

    lv_obj_t* lbl = lv_label_create(btn);
    lv_label_set_text(lbl, txt);
    lv_obj_set_style_text_color(lbl, lv_color_white(), LV_PART_MAIN);
    lv_obj_set_style_text_font(lbl, &lv_font_montserrat_14, LV_PART_MAIN);
    lv_obj_center(lbl);
    if (outLbl) *outLbl = lbl;
    return btn;
}

// Transparent container used to group and show/hide button rows
static lv_obj_t* makeRow(lv_obj_t* parent, int x, int y, int w, int h) {
    lv_obj_t* row = lv_obj_create(parent);
    lv_obj_remove_style_all(row);
    lv_obj_set_pos(row, x, y);
    lv_obj_set_size(row, w, h);
    lv_obj_set_style_bg_opa(row, LV_OPA_TRANSP, LV_PART_MAIN);
    lv_obj_clear_flag(row, (lv_obj_flag_t)(LV_OBJ_FLAG_CLICKABLE | LV_OBJ_FLAG_SCROLLABLE));
    return row;
}

static void makeSep(lv_obj_t* parent, int x, int y, int w, int h) {
    lv_obj_t* sep = lv_obj_create(parent);
    lv_obj_remove_style_all(sep);
    lv_obj_set_pos(sep, x, y);
    lv_obj_set_size(sep, w, h);
    lv_obj_set_style_bg_color(sep, lv_color_hex(C_SEP), LV_PART_MAIN);
    lv_obj_set_style_bg_opa(sep, LV_OPA_COVER, LV_PART_MAIN);
    lv_obj_clear_flag(sep, (lv_obj_flag_t)(LV_OBJ_FLAG_CLICKABLE | LV_OBJ_FLAG_SCROLLABLE));
}

static lv_obj_t* makeSecLabel(lv_obj_t* parent, int x, int y, const char* txt) {
    lv_obj_t* lbl = lv_label_create(parent);
    lv_obj_set_style_text_font(lbl, &lv_font_montserrat_14, LV_PART_MAIN);
    lv_obj_set_style_text_color(lbl, lv_color_hex(C_LABEL), LV_PART_MAIN);
    lv_label_set_text(lbl, txt);
    lv_obj_set_pos(lbl, x, y);
    return lbl;
}

// ═══════════════════════════════════════════════════════════════════════════
// refreshControls — re-syncs button colours and visibility to current state
// ═══════════════════════════════════════════════════════════════════════════
static void refreshControls() {
    if (!s_heatOn || !s_roomSp || !s_waterSp || !s_fanMode) return;

    bool heat   = (s_heatOn->getIntValue() != 0);
    int  fanVal = s_fanMode->getIntValue();   // -1=eco, -2=high, 0=off, 1-10=numeric

    // ── Heating button ────────────────────────────────────────────────────
    if (s_heatBtnLbl)
        lv_label_set_text(s_heatBtnLbl, heat ? t(TK::HEAT_ON) : t(TK::HEAT_OFF));
    if (s_heatBtn)
        lv_obj_set_style_bg_color(s_heatBtn,
            lv_color_hex(heat ? C_HEAT_ON : C_BTN_OFF), LV_PART_MAIN);

    // ── Temperature setpoint ─────────────────────────────────────────────
    if (s_spRow) {
        if (heat) {
            lv_obj_remove_flag(s_spRow, LV_OBJ_FLAG_HIDDEN);
            if (s_spLbl) {
                char buf[12];
                snprintf(buf, sizeof(buf), "%.1f\xc2\xb0""C", s_roomSp->getFloatValue());
                lv_label_set_text(s_spLbl, buf);
            }
        } else {
            lv_obj_add_flag(s_spRow, LV_OBJ_FLAG_HIDDEN);
        }
    }

    // ── Fan ───────────────────────────────────────────────────────────────
    if (heat) {
        if (s_fanHeatingRow) lv_obj_remove_flag(s_fanHeatingRow, LV_OBJ_FLAG_HIDDEN);
        if (s_fanOffRow)     lv_obj_add_flag(s_fanOffRow,   LV_OBJ_FLAG_HIDDEN);
        if (s_fanLevelRow)   lv_obj_add_flag(s_fanLevelRow, LV_OBJ_FLAG_HIDDEN);

        String fanStr = s_fanMode->getStringValue();
        for (int i = 0; i < FAN_HEAT_N; i++) {
            if (s_fanBtn[i])
                lv_obj_set_style_bg_color(s_fanBtn[i],
                    lv_color_hex((fanStr == FAN_STR[i]) ? C_BTN_ON : C_BTN_OFF),
                    LV_PART_MAIN);
        }
    } else {
        if (s_fanHeatingRow) lv_obj_add_flag(s_fanHeatingRow, LV_OBJ_FLAG_HIDDEN);
        if (s_fanOffRow)     lv_obj_remove_flag(s_fanOffRow,  LV_OBJ_FLAG_HIDDEN);

        bool fanOn = (fanVal != 0);

        if (fanVal > 0) s_fanLevel = fanVal;

        // Show level row whenever the fan is on. Previously hidden while
        // the boiler was active, but that meant settings made from the web
        // (which has no such block) could not be tweaked from the screen.
        if (s_fanLevelRow) {
            if (fanOn) lv_obj_remove_flag(s_fanLevelRow, LV_OBJ_FLAG_HIDDEN);
            else       lv_obj_add_flag   (s_fanLevelRow, LV_OBJ_FLAG_HIDDEN);
        }

        if (s_fanOnBtn && s_fanOffBtn) {
            lv_obj_remove_state(s_fanOnBtn,  LV_STATE_DISABLED);
            lv_obj_remove_state(s_fanOffBtn, LV_STATE_DISABLED);
            lv_obj_set_style_bg_color(s_fanOnBtn,
                lv_color_hex(fanOn  ? C_BTN_ON : C_BTN_OFF), LV_PART_MAIN);
            lv_obj_set_style_bg_color(s_fanOffBtn,
                lv_color_hex(!fanOn ? C_BTN_ON : C_BTN_OFF), LV_PART_MAIN);
        }

        if (s_fanLevelLbl) {
            char buf[4];
            snprintf(buf, sizeof(buf), "%d", s_fanLevel);
            lv_label_set_text(s_fanLevelLbl, buf);
        }
    }

    // ── Boiler / Hot water ───────────────────────────────────────────────
    String boiler = s_waterSp->getStringValue();
    for (int i = 0; i < BOILER_N; i++) {
        if (s_boilerBtn[i])
            lv_obj_set_style_bg_color(s_boilerBtn[i],
                lv_color_hex((boiler == BOILER_STR[i]) ? C_BTN_ON : C_BTN_OFF),
                LV_PART_MAIN);
    }
}

// ═══════════════════════════════════════════════════════════════════════════
// Callbacks
// ═══════════════════════════════════════════════════════════════════════════
static void heatCb(lv_event_t*) {
    if (!s_heatOn) return;
    bool turningOff = (s_heatOn->getIntValue() != 0);
    s_heatOn->setValue(String(turningOff ? "0" : "1"));
    if (turningOff && s_fanMode) s_fanMode->setValue(String("off"));
    refreshControls();
}

static void spDownCb(lv_event_t*) {
    if (!s_roomSp) return;
    double v = s_roomSp->getFloatValue() - 0.5;
    if (v >= 5.0) s_roomSp->setValue(v);
    refreshControls();
}

static void spUpCb(lv_event_t*) {
    if (!s_roomSp) return;
    double v = s_roomSp->getFloatValue() + 0.5;
    if (v <= 30.0) s_roomSp->setValue(v);
    refreshControls();
}

static void boilerCb(lv_event_t* e) {
    if (!s_waterSp) return;
    int idx = (int)(intptr_t)lv_event_get_user_data(e);
    // When activating the boiler, pre-emptively set fan to off. The Truma applies
    // any pending fan command when it cycles, which could cause unexpected fan starts.
    if (idx != 0 && s_fanMode) s_fanMode->setValue(String("off"));
    s_waterSp->setValue(String(BOILER_STR[idx]));
    refreshControls();
}

static void fanHeatCb(lv_event_t* e) {
    if (!s_fanMode) return;
    int idx = (int)(intptr_t)lv_event_get_user_data(e);
    s_fanMode->setValue(String(FAN_STR[idx]));
    refreshControls();
}

// Fan callbacks no longer block on s_waterSp != "off". The web has no such
// guard, so blocking only the physical path made the UI inconsistent
// (button could turn ON via web while physical level controls stayed hidden).
static void fanOnCb(lv_event_t*) {
    if (!s_fanMode) return;
    s_fanMode->setValue(String(s_fanLevel));
    refreshControls();
}

static void fanOffCb(lv_event_t*) {
    if (!s_fanMode) return;
    s_fanMode->setValue(String("off"));
    refreshControls();
}

static void fanLevelDownCb(lv_event_t*) {
    if (!s_fanMode) return;
    if (s_fanLevel > 1) {
        s_fanLevel--;
        if (s_fanMode->getIntValue() > 0) s_fanMode->setValue(String(s_fanLevel));
        refreshControls();
    }
}

static void fanLevelUpCb(lv_event_t*) {
    if (!s_fanMode) return;
    if (s_fanLevel < 10) {
        s_fanLevel++;
        if (s_fanMode->getIntValue() > 0) s_fanMode->setValue(String(s_fanLevel));
        refreshControls();
    }
}

static void energyDdCb(lv_event_t* e) {
    lv_obj_t* dd = (lv_obj_t*)lv_event_get_target(e);
    s_energyMode = (int)lv_dropdown_get_selected(dd);
}

// ═══════════════════════════════════════════════════════════════════════════
// Public API: energy mode (read by main.cpp each loop iteration)
// ═══════════════════════════════════════════════════════════════════════════
int cydGetEnergyMode() { return s_energyMode; }

void cydSetEnergyIdx(int idx) {
    if (idx < 0 || idx > 4) return;
    s_energyMode = idx;
    if (s_energyDd) lv_dropdown_set_selected(s_energyDd, (uint16_t)idx);
}

// ═══════════════════════════════════════════════════════════════════════════
// NVS — screen-off timeout
// ═══════════════════════════════════════════════════════════════════════════
static void loadTimeoutIdx() {
    Preferences p;
    p.begin("cyd", true);
    s_timeoutIdx = p.getInt("timeout_idx", 0);
    p.end();
}
static void saveTimeoutIdx() {
    Preferences p;
    p.begin("cyd", false);
    p.putInt("timeout_idx", s_timeoutIdx);
    p.end();
}

// ═══════════════════════════════════════════════════════════════════════════
// Wake-on-touch overlay  (lives on lv_layer_top, above every screen)
// ═══════════════════════════════════════════════════════════════════════════
static void wakeCb(lv_event_t*) {
    if (!s_screenOff) return;
    blFadeTo(1.0f);
    s_screenOff = false;
    if (s_wakeOverlay) { lv_obj_delete(s_wakeOverlay); s_wakeOverlay = nullptr; }
}

// ═══════════════════════════════════════════════════════════════════════════
// Display settings screen
// ═══════════════════════════════════════════════════════════════════════════
static void refreshDisplayOpts() {
    for (int i = 0; i < TIMEOUT_N; i++) {
        if (s_dispOptBtn[i])
            lv_obj_set_style_bg_color(s_dispOptBtn[i],
                lv_color_hex(i == s_timeoutIdx ? C_BTN_ON : C_BTN_OFF),
                LV_PART_MAIN);
    }
}

static void navigateBackFromDisplay() {
    lv_obj_t* old = s_displayScr;
    s_displayScr  = nullptr;
    for (int i = 0; i < TIMEOUT_N; i++) s_dispOptBtn[i] = nullptr;
    lv_screen_load(s_scr);
    if (old) lv_obj_delete(old);
    showSettingsMenu();
}

static void dispOptCb(lv_event_t* e) {
    s_timeoutIdx = (int)(intptr_t)lv_event_get_user_data(e);
    saveTimeoutIdx();
    navigateBackFromDisplay();
}

static void dispBackCb(lv_event_t*) { navigateBackFromDisplay(); }

static void showDisplaySettings() {
    if (s_displayScr) return;

    lv_obj_t* scr = lv_obj_create(NULL);
    lv_obj_remove_style_all(scr);
    lv_obj_set_style_bg_color(scr, lv_color_hex(C_BG), LV_PART_MAIN);
    lv_obj_set_style_bg_opa (scr, LV_OPA_COVER,        LV_PART_MAIN);
    lv_obj_clear_flag(scr, (lv_obj_flag_t)LV_OBJ_FLAG_SCROLLABLE);
    s_displayScr = scr;

    lv_obj_t* topBar = lv_obj_create(scr);
    lv_obj_remove_style_all(topBar);
    lv_obj_set_pos(topBar, 0, 0);
    lv_obj_set_size(topBar, 320, Y_TOP_H);
    lv_obj_set_style_bg_color(topBar, lv_color_hex(C_TOPBAR), LV_PART_MAIN);
    lv_obj_set_style_bg_opa (topBar, LV_OPA_COVER,             LV_PART_MAIN);
    lv_obj_clear_flag(topBar, (lv_obj_flag_t)(LV_OBJ_FLAG_CLICKABLE | LV_OBJ_FLAG_SCROLLABLE));

    lv_obj_t* backBtn = makeBtn(topBar, 2, 2, 70, 24,
                                symText(LV_SYMBOL_LEFT, TK::BACK), dispBackCb);
    lv_obj_set_style_bg_color(backBtn, lv_color_hex(C_TOPBAR), LV_PART_MAIN);

    lv_obj_t* ttl = lv_label_create(topBar);
    lv_obj_set_style_text_font(ttl, &lv_font_montserrat_14, LV_PART_MAIN);
    lv_obj_set_style_text_color(ttl, lv_color_white(), LV_PART_MAIN);
    lv_label_set_text(ttl, t(TK::DISPLAY_TITLE));
    lv_obj_align(ttl, LV_ALIGN_CENTER, 0, 0);

    makeSep(scr, 0, Y_SEP1, 320, 1);
    makeSecLabel(scr, 8, Y_CONT + 4, t(TK::TIMEOUT_LABEL));

    const int bx = 8, bw = 304, bh = 34, bgap = 4;
    int by = Y_CONT + 24;
    for (int i = 0; i < TIMEOUT_N; i++) {
        s_dispOptBtn[i] = makeBtn(scr, bx, by, bw, bh,
                                   t(TIMEOUT_TK[i]), dispOptCb,
                                   (void*)(intptr_t)i);
        by += bh + bgap;
    }
    refreshDisplayOpts();
    lv_screen_load(scr);
}

// ═══════════════════════════════════════════════════════════════════════════
// Language selection screen (blocking busy-wait)
// ═══════════════════════════════════════════════════════════════════════════
static volatile int s_langSelected = -1;   // -1 = no selection yet
static void langEnCb(lv_event_t*) { s_langSelected = (int)Language::EN; }
static void langEsCb(lv_event_t*) { s_langSelected = (int)Language::ES; }

static void showLangSelectBlocking() {
    s_langSelected = -1;

    lv_obj_t* scr = lv_obj_create(NULL);
    lv_obj_remove_style_all(scr);
    lv_obj_set_style_bg_color(scr, lv_color_hex(C_BG), LV_PART_MAIN);
    lv_obj_set_style_bg_opa (scr, LV_OPA_COVER,        LV_PART_MAIN);
    lv_obj_clear_flag(scr, (lv_obj_flag_t)(LV_OBJ_FLAG_CLICKABLE | LV_OBJ_FLAG_SCROLLABLE));

    lv_obj_t* title = lv_label_create(scr);
    lv_label_set_text(title, "TruMinus");
    lv_obj_set_style_text_font(title, &lv_font_montserrat_20, LV_PART_MAIN);
    lv_obj_set_style_text_color(title, lv_color_white(), LV_PART_MAIN);
    lv_obj_align(title, LV_ALIGN_TOP_MID, 0, 38);

    lv_obj_t* sub = lv_label_create(scr);
    lv_label_set_text(sub, "Select language / Selecciona idioma");
    lv_obj_set_style_text_font(sub, &lv_font_montserrat_14, LV_PART_MAIN);
    lv_obj_set_style_text_color(sub, lv_color_hex(C_LABEL), LV_PART_MAIN);
    lv_obj_align(sub, LV_ALIGN_TOP_MID, 0, 74);

    // Two large buttons centred on screen
    makeBtn(scr, 20,  130, 130, 60, "English", langEnCb);
    makeBtn(scr, 170, 130, 130, 60, "Espanol", langEsCb);

    lv_screen_load(scr);
    lv_refr_now(lv_display_get_default());   // force immediate render — flush state may be stale after splash

    uint32_t _tickLast = millis();
    while (s_langSelected == -1) {
        uint32_t _tickNow = millis();
        lv_tick_inc(_tickNow - _tickLast);
        _tickLast = _tickNow;
        lv_task_handler(); delay(5);
    }

    setLanguage((Language)s_langSelected);

    // Switch away from `scr` BEFORE deleting it. Deleting the active screen
    // leaves LVGL with a dangling act_scr pointer and the next lv_screen_load()
    // call from the caller silently fails — the UI then appears frozen.
    // Same pattern as showSplash() above.
    lv_obj_t* blank = lv_obj_create(NULL);
    lv_screen_load_anim(blank, LV_SCR_LOAD_ANIM_NONE, 0, 0, /*auto_del=*/true);
    lv_tick_inc(5);
    lv_task_handler();   // commit the switch; old scr is deleted here
}

void cydShowLangSelect() { showLangSelectBlocking(); }

// ═══════════════════════════════════════════════════════════════════════════
// Main settings menu
// ═══════════════════════════════════════════════════════════════════════════
// Plain dark placeholder shown while the main loop dispatches a nav request
// and rebuilds the heavy setup screen. Without it the user saw a flash of the
// main UI between closing the settings menu and the setup screen loading.
static lv_obj_t* s_navTransition = nullptr;
static void loadNavTransition() {
    lv_obj_t* scr = lv_obj_create(NULL);
    lv_obj_remove_style_all(scr);
    lv_obj_set_style_bg_color(scr, lv_color_hex(C_BG), LV_PART_MAIN);
    lv_obj_set_style_bg_opa  (scr, LV_OPA_COVER,        LV_PART_MAIN);
    lv_obj_clear_flag(scr, (lv_obj_flag_t)LV_OBJ_FLAG_SCROLLABLE);
    lv_screen_load(scr);
    s_navTransition = scr;
}

static void settingsBackCb(lv_event_t*) {
    lv_obj_t* old = s_settingsScr;
    s_settingsScr = nullptr;
    lv_screen_load(s_scr);
    if (old) lv_obj_delete(old);
}

static void wifiConfigCb(lv_event_t*) {
    lv_obj_t* old = s_settingsScr;
    s_settingsScr = nullptr;
    s_navRequest  = CydNavRequest::WifiSetup;
    loadNavTransition();
    if (old) lv_obj_delete(old);
}

static void displayConfigCb(lv_event_t*) {
    lv_obj_t* old = s_settingsScr;
    s_settingsScr = nullptr;
    // Display-settings screen is built right here (no main-loop round-trip), so
    // we don't need the dark placeholder — showDisplaySettings() loads its own
    // screen synchronously. We just need a valid active screen during delete.
    lv_screen_load(s_scr);
    if (old) lv_obj_delete(old);
    showDisplaySettings();
}

static void langConfigCb(lv_event_t*) {
    lv_obj_t* old = s_settingsScr;
    s_settingsScr = nullptr;
    s_navRequest  = CydNavRequest::LangChange;
    loadNavTransition();
    if (old) lv_obj_delete(old);
}

static void solarConfigCb(lv_event_t*) {
    lv_obj_t* old = s_settingsScr;
    s_settingsScr = nullptr;
    s_navRequest  = CydNavRequest::SolarSetup;
    loadNavTransition();
    if (old) lv_obj_delete(old);
}

static void showSettingsMenu() {
    if (s_settingsScr) return;

    lv_obj_t* scr = lv_obj_create(NULL);
    lv_obj_remove_style_all(scr);
    lv_obj_set_style_bg_color(scr, lv_color_hex(C_BG), LV_PART_MAIN);
    lv_obj_set_style_bg_opa (scr, LV_OPA_COVER,        LV_PART_MAIN);
    lv_obj_clear_flag(scr, (lv_obj_flag_t)LV_OBJ_FLAG_SCROLLABLE);
    s_settingsScr = scr;

    lv_obj_t* topBar = lv_obj_create(scr);
    lv_obj_remove_style_all(topBar);
    lv_obj_set_pos(topBar, 0, 0);
    lv_obj_set_size(topBar, 320, Y_TOP_H);
    lv_obj_set_style_bg_color(topBar, lv_color_hex(C_TOPBAR), LV_PART_MAIN);
    lv_obj_set_style_bg_opa (topBar, LV_OPA_COVER,             LV_PART_MAIN);
    lv_obj_clear_flag(topBar, (lv_obj_flag_t)(LV_OBJ_FLAG_CLICKABLE | LV_OBJ_FLAG_SCROLLABLE));

    lv_obj_t* backBtn = makeBtn(topBar, 2, 2, 70, 24,
                                symText(LV_SYMBOL_LEFT, TK::BACK), settingsBackCb);
    lv_obj_set_style_bg_color(backBtn, lv_color_hex(C_TOPBAR), LV_PART_MAIN);

    lv_obj_t* ttl = lv_label_create(topBar);
    lv_obj_set_style_text_font(ttl, &lv_font_montserrat_14, LV_PART_MAIN);
    lv_obj_set_style_text_color(ttl, lv_color_white(), LV_PART_MAIN);
    lv_label_set_text(ttl, t(TK::SETTINGS));
    lv_obj_align(ttl, LV_ALIGN_CENTER, 0, 0);

    makeSep(scr, 0, Y_SEP1, 320, 1);

    // 5 buttons: bh=34, bgap=5 → 5×34+4×5=190 px (screen is 240, top bar=28 → 202 px avail)
    const int bx = 8, bw = 304, bh = 34, bgap = 5;
    int by = Y_CONT + 6;

    makeBtn(scr, bx, by,               bw, bh,
            symText(LV_SYMBOL_WIFI,     TK::WIFI_CFG),  wifiConfigCb);
    makeBtn(scr, bx, by +   (bh+bgap), bw, bh,
            symText(LV_SYMBOL_SETTINGS, TK::DISP_CFG),  displayConfigCb);
    makeBtn(scr, bx, by + 2*(bh+bgap), bw, bh,
            symText(LV_SYMBOL_KEYBOARD, TK::LANGUAGE),  langConfigCb);
    makeBtn(scr, bx, by + 3*(bh+bgap), bw, bh,
            symText(LV_SYMBOL_CHARGE,   TK::SOLAR_CFG), solarConfigCb);

    lv_screen_load(scr);
}

static void gearCb(lv_event_t*) { showSettingsMenu(); }

void cydOpenSettingsMenu() { showSettingsMenu(); }

// ═══════════════════════════════════════════════════════════════════════════
// Public API: navigation and screen reload
// ═══════════════════════════════════════════════════════════════════════════
CydNavRequest cydGetNavRequest()   { return s_navRequest; }
void          cydClearNavRequest() { s_navRequest = CydNavRequest::None; }

void cydReloadScreen() {
    if (s_wakeOverlay) { lv_obj_delete(s_wakeOverlay); s_wakeOverlay = nullptr; }
    s_screenOff = false;
    blFadeTo(1.0f);
    if (s_scr) lv_screen_load(s_scr);
    // The nav-transition placeholder, if any, is now orphan — free it.
    if (s_navTransition) { lv_obj_delete(s_navTransition); s_navTransition = nullptr; }
}

bool cydIsScreenOff() { return s_screenOff; }

// ═══════════════════════════════════════════════════════════════════════════
// Error modal
// ═══════════════════════════════════════════════════════════════════════════
static void errModalOkCb(lv_event_t*) {
    if (s_errorModal) { lv_obj_delete(s_errorModal); s_errorModal = nullptr; }
    s_errAcked = true;
}

static void showErrorModal(uint8_t cls, uint8_t code) {
    if (s_errorModal) { lv_obj_delete(s_errorModal); s_errorModal = nullptr; }

    uint32_t    col;
    TK          lblKey;
    if (cls == 1 || cls == 2) { col = C_WARN;       lblKey = TK::WARN_LBL;   }
    else if (cls == 40)        { col = C_ERR_LOCKED; lblKey = TK::LOCKED_LBL; }
    else                       { col = C_WIFI_NO;    lblKey = TK::ERROR_LBL;  }

    // Semi-transparent overlay on s_scr (on top due to creation order)
    s_errorModal = lv_obj_create(s_scr);
    lv_obj_remove_style_all(s_errorModal);
    lv_obj_set_pos(s_errorModal, 0, 0);
    lv_obj_set_size(s_errorModal, 320, 240);
    lv_obj_set_style_bg_color(s_errorModal, lv_color_hex(0x000000), LV_PART_MAIN);
    lv_obj_set_style_bg_opa(s_errorModal, LV_OPA_70, LV_PART_MAIN);
    lv_obj_clear_flag(s_errorModal, LV_OBJ_FLAG_SCROLLABLE);

    lv_obj_t* box = lv_obj_create(s_errorModal);
    lv_obj_set_size(box, 240, 110);
    lv_obj_align(box, LV_ALIGN_CENTER, 0, 0);
    lv_obj_set_style_bg_color(box, lv_color_hex(C_TOPBAR), LV_PART_MAIN);
    lv_obj_set_style_border_color(box, lv_color_hex(col), LV_PART_MAIN);
    lv_obj_set_style_border_width(box, 1, LV_PART_MAIN);
    lv_obj_set_style_radius(box, 6, LV_PART_MAIN);
    lv_obj_set_style_pad_all(box, 8, LV_PART_MAIN);
    lv_obj_clear_flag(box, LV_OBJ_FLAG_SCROLLABLE);

    lv_obj_t* title = lv_label_create(box);
    lv_label_set_text(title, t(lblKey));
    lv_obj_set_style_text_color(title, lv_color_hex(col), LV_PART_MAIN);
    lv_obj_set_style_text_font(title, &lv_font_montserrat_14, LV_PART_MAIN);
    lv_obj_align(title, LV_ALIGN_TOP_MID, 0, 0);

    char sub[40];
    snprintf(sub, sizeof(sub), t(TK::ERR_SUBTITLE_FMT), cls, code);
    lv_obj_t* sublbl = lv_label_create(box);
    lv_label_set_text(sublbl, sub);
    lv_obj_set_style_text_color(sublbl, lv_color_hex(C_LABEL), LV_PART_MAIN);
    lv_obj_set_style_text_font(sublbl, &lv_font_montserrat_14, LV_PART_MAIN);
    lv_obj_align(sublbl, LV_ALIGN_TOP_MID, 0, 22);

    lv_obj_t* btn = makeBtn(box, 0, 0, 100, 32, t(TK::ACCEPT), errModalOkCb);
    lv_obj_align(btn, LV_ALIGN_BOTTOM_MID, 0, 0);
}

// ═══════════════════════════════════════════════════════════════════════════
// buildMainUI — creates all widgets as children of s_scr
// Separated from cydDisplayInit so it can be called again by cydRebuildUI().
// ═══════════════════════════════════════════════════════════════════════════
static void buildMainUI() {
    // ── Top bar ───────────────────────────────────────────────────────────
    lv_obj_t* topBar = lv_obj_create(s_scr);
    lv_obj_remove_style_all(topBar);
    lv_obj_set_pos(topBar, 0, 0);
    lv_obj_set_size(topBar, 320, Y_TOP_H);
    lv_obj_set_style_bg_color(topBar, lv_color_hex(C_TOPBAR), LV_PART_MAIN);
    lv_obj_set_style_bg_opa(topBar, LV_OPA_COVER, LV_PART_MAIN);
    lv_obj_clear_flag(topBar, (lv_obj_flag_t)(LV_OBJ_FLAG_CLICKABLE | LV_OBJ_FLAG_SCROLLABLE));

    // Tint icon (left) — blinks when boiler is heating
    s_aguaLbl = lv_label_create(topBar);
    lv_obj_set_style_text_font(s_aguaLbl, &symbols_14, LV_PART_MAIN);
    lv_obj_set_style_text_color(s_aguaLbl, lv_color_hex(0xaaccff), LV_PART_MAIN);
    lv_obj_set_style_text_opa(s_aguaLbl, LV_OPA_20, LV_PART_MAIN);
    lv_label_set_text(s_aguaLbl, MY_SYMBOL_TINT);
    lv_obj_set_pos(s_aguaLbl, 5, 7);

    // Flame icon — blinks when heating is active and demanding
    s_fireLbl = lv_label_create(topBar);
    lv_obj_set_style_text_font(s_fireLbl, &symbols_14, LV_PART_MAIN);
    lv_obj_set_style_text_color(s_fireLbl, lv_color_hex(0xaaccff), LV_PART_MAIN);
    lv_obj_set_style_text_opa(s_fireLbl, LV_OPA_20, LV_PART_MAIN);
    lv_label_set_text(s_fireLbl, MY_SYMBOL_FIRE);
    lv_obj_set_pos(s_fireLbl, 22, 7);

    // Indoor temperature
    s_ambLbl = lv_label_create(topBar);
    lv_obj_set_style_text_font(s_ambLbl, &symbols_14, LV_PART_MAIN);
    lv_obj_set_style_text_color(s_ambLbl, lv_color_hex(0xaaccff), LV_PART_MAIN);
    lv_label_set_text(s_ambLbl, MY_SYMBOL_THERMOMETER " -- \xc2\xb0""C");
    lv_obj_set_pos(s_ambLbl, 44, 7);

    // Outdoor temperature (AM2301)
    s_extLbl = lv_label_create(topBar);
    lv_obj_set_style_text_font(s_extLbl, &symbols_14, LV_PART_MAIN);
    lv_obj_set_style_text_color(s_extLbl, lv_color_hex(0xffcc88), LV_PART_MAIN);
    lv_label_set_text(s_extLbl, MY_SYMBOL_THERM_EXT " " MY_SYMBOL_CHEVRON_R " --\xc2\xb0""C");
    lv_obj_set_pos(s_extLbl, 117, 7);
    lv_obj_clear_flag(s_extLbl, LV_OBJ_FLAG_CLICKABLE);

    auto makeStatusIcon = [&](int x, const char* sym, uint32_t col) -> lv_obj_t* {
        lv_obj_t* lbl = lv_label_create(topBar);
        lv_obj_set_style_text_font(lbl, &lv_font_montserrat_14, LV_PART_MAIN);
        lv_obj_set_style_text_color(lbl, lv_color_hex(col), LV_PART_MAIN);
        lv_label_set_text(lbl, sym);
        lv_obj_set_pos(lbl, x, 6);
        lv_obj_clear_flag(lbl, LV_OBJ_FLAG_CLICKABLE);
        return lbl;
    };

    // Config button: centered between outdoor temp (~x=180) and WiFi icon (x=272)
    {
        char buf[24];
        snprintf(buf, sizeof(buf), "%s %s", LV_SYMBOL_SETTINGS, t(TK::CONF));
        lv_obj_t* confBtn = makeBtn(topBar, 186, 4, 72, 20, buf, gearCb);
        lv_obj_set_style_bg_color(confBtn, lv_color_hex(C_BTN_OFF), LV_PART_MAIN);
        lv_obj_set_style_bg_color(confBtn, lv_color_hex(C_BTN_ON), LV_STATE_PRESSED);
        lv_obj_set_style_text_color(lv_obj_get_child(confBtn, 0), lv_color_white(), LV_PART_MAIN);
    }

    s_wifiDot = makeStatusIcon(272, LV_SYMBOL_WIFI,    C_WIFI_NO);
    s_linDot  = makeStatusIcon(296, LV_SYMBOL_SHUFFLE, C_WIFI_NO);

    // ── Separators ───────────────────────────────────────────────────────
    makeSep(s_scr, 0,     Y_SEP1, 320, 1);    // horizontal top
    makeSep(s_scr, X_DIV, Y_CONT, 1, CONT_H); // vertical (x=153)
    makeSep(s_scr, 0,     Y_SEP2, 320, 1);    // horizontal bottom

    // ════════════════════════════════════════════════════════════════════
    // LEFT PANEL — HEATING
    // Content width: W_L - 8 = 146 px  (4 px margin on each side)
    // ════════════════════════════════════════════════════════════════════
    const int lx = 4;
    const int lw = W_L - 8;   // 146 px

    makeSecLabel(s_scr, lx, Y_CONT + 2, t(TK::HEATING));

    s_heatBtn = makeBtn(s_scr, lx, Y_CONT + 20, lw, 36,
                        t(TK::HEAT_OFF), heatCb, nullptr, &s_heatBtnLbl);
    lv_obj_set_style_text_font(s_heatBtnLbl, &lv_font_montserrat_14, LV_PART_MAIN);

    // Setpoint row (hidden when heating is OFF)
    s_spRow = makeRow(s_scr, lx, Y_CONT + 62, lw, 35);
    lv_obj_add_flag(s_spRow, LV_OBJ_FLAG_HIDDEN);

    makeBtn(s_spRow, 0, 0, 36, 35, LV_SYMBOL_DOWN, spDownCb);

    s_spLbl = lv_label_create(s_spRow);
    lv_obj_set_style_text_font(s_spLbl, &lv_font_montserrat_16, LV_PART_MAIN);
    lv_obj_set_style_text_color(s_spLbl, lv_color_white(), LV_PART_MAIN);
    lv_obj_set_style_text_align(s_spLbl, LV_TEXT_ALIGN_CENTER, LV_PART_MAIN);
    lv_obj_set_size(s_spLbl, 52, 35);
    lv_obj_set_pos(s_spLbl, 38, 10);
    lv_label_set_text(s_spLbl, "20.0\xc2\xb0""C");

    makeBtn(s_spRow, lw - 36, 0, 36, 35, LV_SYMBOL_UP, spUpCb);

    // ── Fan section ───────────────────────────────────────────────────────
    makeSecLabel(s_scr, lx, Y_CONT + 99, t(TK::FAN));

    // Heating mode row: Eco | High  (no Off button, visible when heat ON)
    // 146 px: 2×71 + 1×4 gap = 146 px
    const int fwh = (lw - 4) / 2;   // ≈ 71 px
    s_fanHeatingRow = makeRow(s_scr, lx, Y_CONT + 115, lw, 28);
    for (int i = 0; i < FAN_HEAT_N; i++) {
        s_fanBtn[i] = makeBtn(s_fanHeatingRow, i * (fwh + 4), 0, fwh, 28,
                               fanHeatLabel(i), fanHeatCb, (void*)(intptr_t)i);
    }

    // Standby mode row: Off | On  (visible when heat OFF)
    // 146 px: 2×68 + 10 gap = 146 px
    const int fwo = (lw - 10) / 2;   // 68 px
    s_fanOffRow = makeRow(s_scr, lx, Y_CONT + 115, lw, 28);
    lv_obj_add_flag(s_fanOffRow, LV_OBJ_FLAG_HIDDEN);
    s_fanOffBtn = makeBtn(s_fanOffRow, 0,        0, fwo, 28, t(TK::OFF), fanOffCb);
    s_fanOnBtn  = makeBtn(s_fanOffRow, fwo + 10, 0, fwo, 28, t(TK::ON),  fanOnCb);

    // Level row: ↓ | N | ↑  (visible when heat OFF and fan On)
    // 146 px: 36 + 2 + 70 + 2 + 36 = 146 px
    s_fanLevelRow = makeRow(s_scr, lx, Y_CONT + 144, lw, 28);
    lv_obj_add_flag(s_fanLevelRow, LV_OBJ_FLAG_HIDDEN);
    makeBtn(s_fanLevelRow, 0, 0, 36, 28, LV_SYMBOL_DOWN, fanLevelDownCb);

    s_fanLevelLbl = lv_label_create(s_fanLevelRow);
    lv_obj_set_style_text_font(s_fanLevelLbl, &lv_font_montserrat_14, LV_PART_MAIN);
    lv_obj_set_style_text_color(s_fanLevelLbl, lv_color_white(), LV_PART_MAIN);
    lv_obj_set_style_text_align(s_fanLevelLbl, LV_TEXT_ALIGN_CENTER, LV_PART_MAIN);
    lv_obj_set_size(s_fanLevelLbl, 50, 28);
    lv_obj_set_pos(s_fanLevelLbl, 38, 7);
    lv_label_set_text(s_fanLevelLbl, "5");

    makeBtn(s_fanLevelRow, lw - 36, 0, 36, 28, LV_SYMBOL_UP, fanLevelUpCb);

    // ════════════════════════════════════════════════════════════════════
    // RIGHT PANEL — HOT WATER
    // ════════════════════════════════════════════════════════════════════
    const int rx = X_R + 2;    // x=144
    const int rw = W_R - 4;    // 174 px

    makeSecLabel(s_scr, rx, Y_CONT + 2, t(TK::HOT_WATER));

    // 4 boiler buttons in a 2×2 grid (left side)
    const int WTC_W  = 46;               // water temp column width
    const int boiler_rw = rw - WTC_W - 5; // remaining width for buttons
    const int bw = (boiler_rw - 9) / 2;
    int bx[4] = {rx, rx + bw + 9, rx, rx + bw + 9};
    int by[4] = {Y_CONT + 20, Y_CONT + 20, Y_CONT + 54, Y_CONT + 54};
    for (int i = 0; i < BOILER_N; i++) {
        s_boilerBtn[i] = makeBtn(s_scr, bx[i], by[i], bw, 30,
                                  boilerLabel(i), boilerCb, (void*)(intptr_t)i);
    }

    const int WTC_X = rx + boiler_rw + 3;

    // ── Water temperature bar (right side, battery-style, no nubs) ───────
    const int WB_W  = 30;                // body width
    const int WB_H  = 54;                // body height (was 40, uses 10px freed above)
    const int WB_X  = WTC_X + (WTC_W - WB_W) / 2;  // centered in column
    const int WB_Y  = Y_CONT + 26;       // body top
    const int WF_IH = WB_H - 2;          // fill inner height (52 px)

    // Temperature value label (above bar, moved up into 10px freed space)
    s_waterTempLbl = lv_label_create(s_scr);
    lv_obj_set_style_text_font(s_waterTempLbl, &lv_font_montserrat_12, LV_PART_MAIN);
    lv_obj_set_style_text_color(s_waterTempLbl, lv_color_white(), LV_PART_MAIN);
    lv_obj_set_style_text_align(s_waterTempLbl, LV_TEXT_ALIGN_CENTER, LV_PART_MAIN);
    lv_obj_set_size(s_waterTempLbl, WTC_W, 14);
    lv_obj_set_pos(s_waterTempLbl, WTC_X, Y_CONT + 8);
    lv_label_set_text(s_waterTempLbl, "--");

    // Bar body: border-only vertical rect
    s_waterTempBody = lv_obj_create(s_scr);
    lv_obj_remove_style_all(s_waterTempBody);
    lv_obj_set_size(s_waterTempBody, WB_W, WB_H);
    lv_obj_set_pos(s_waterTempBody, WB_X, WB_Y);
    lv_obj_set_style_bg_opa(s_waterTempBody, LV_OPA_0, LV_PART_MAIN);
    lv_obj_set_style_border_color(s_waterTempBody, lv_color_hex(0x888888), LV_PART_MAIN);
    lv_obj_set_style_border_width(s_waterTempBody, 1, LV_PART_MAIN);
    lv_obj_set_style_radius(s_waterTempBody, 2, LV_PART_MAIN);
    lv_obj_clear_flag(s_waterTempBody, (lv_obj_flag_t)LV_OBJ_FLAG_SCROLLABLE);

    s_waterTempFillX = WB_X + 1;

    // Bar fill: bottom-anchored, height updated by updateWaterTempWidget()
    s_waterTempFill = lv_obj_create(s_scr);
    lv_obj_remove_style_all(s_waterTempFill);
    lv_obj_set_size(s_waterTempFill, WB_W - 2, 0);
    lv_obj_set_pos(s_waterTempFill, s_waterTempFillX, WB_Y + 1 + WF_IH);
    lv_obj_set_style_bg_opa(s_waterTempFill, LV_OPA_COVER, LV_PART_MAIN);
    lv_obj_set_style_bg_color(s_waterTempFill, lv_color_hex(0x4488ff), LV_PART_MAIN);
    lv_obj_set_style_radius(s_waterTempFill, 1, LV_PART_MAIN);
    lv_obj_clear_flag(s_waterTempFill, (lv_obj_flag_t)LV_OBJ_FLAG_SCROLLABLE);

    // Horizontal separator between HOT WATER and SOLAR sections
    makeSep(s_scr, rx, Y_CONT + 86, rw, 1);

    // ── Solar data (left column) + Battery SOC (right column) ────────────
    const int SC_W  = 126;               // solar column width
    const int BC_X  = rx + SC_W + 2;    // battery column x (~272)
    const int BC_W  = rw - SC_W - 2;    // battery column width (~46 px)
    // Battery pill icon (vertical): body 34×39, two nubs 6×6 above body
    const int BB_W  = 34;                        // body width
    const int BB_X  = BC_X + (BC_W - BB_W) / 2; // body left edge (centered)
    const int BB_H  = 47;                        // body height
    const int BF_IH = BB_H - 2;                 // fill inner height (45 px)
    const int BB_Y  = Y_CONT + 118;             // body top (unchanged)

    // Section label — uppercase like HEATING/FAN/HOT_WATER
    makeSecLabel(s_scr, rx, Y_CONT + 88,
        currentLanguage() == Language::EN ? "SOLAR CHARGE" : "CARGA SOLAR");

    // Solar data: 4 rows × 16 px = 64 px, starting Y+108 (looser gap from title)
    // State line — e.g. "Bulk" / "Float" / "--"
    s_solarStateLbl = lv_label_create(s_scr);
    lv_obj_set_style_text_font(s_solarStateLbl, &lv_font_montserrat_14, LV_PART_MAIN);
    lv_obj_set_style_text_color(s_solarStateLbl, lv_color_white(), LV_PART_MAIN);
    lv_obj_set_size(s_solarStateLbl, SC_W, 16);
    lv_obj_set_pos(s_solarStateLbl, rx, Y_CONT + 108);
    lv_label_set_long_mode(s_solarStateLbl, LV_LABEL_LONG_DOT);
    lv_label_set_text(s_solarStateLbl, "--");

    // Voltage line — "Volt.: 12.6V"  (montserrat_12 fits more chars in 106 px)
    s_solarVoltLbl = lv_label_create(s_scr);
    lv_obj_set_style_text_font(s_solarVoltLbl, &lv_font_montserrat_12, LV_PART_MAIN);
    lv_obj_set_style_text_color(s_solarVoltLbl, lv_color_hex(0xaaccff), LV_PART_MAIN);
    lv_obj_set_size(s_solarVoltLbl, SC_W, 16);
    lv_obj_set_pos(s_solarVoltLbl, rx, Y_CONT + 125);
    lv_label_set_text(s_solarVoltLbl, "--");

    // Load line — "Carga: 5.2A / 35W"
    s_solarLoadLbl = lv_label_create(s_scr);
    lv_obj_set_style_text_font(s_solarLoadLbl, &lv_font_montserrat_12, LV_PART_MAIN);
    lv_obj_set_style_text_color(s_solarLoadLbl, lv_color_hex(0x88ccff), LV_PART_MAIN);
    lv_obj_set_size(s_solarLoadLbl, SC_W, 16);
    lv_obj_set_pos(s_solarLoadLbl, rx, Y_CONT + 142);
    lv_label_set_text(s_solarLoadLbl, "--");

    // Production line — "Prod.: 1.45kWh"
    s_solarProdLbl = lv_label_create(s_scr);
    lv_obj_set_style_text_font(s_solarProdLbl, &lv_font_montserrat_12, LV_PART_MAIN);
    lv_obj_set_style_text_color(s_solarProdLbl, lv_color_hex(0xffdd66), LV_PART_MAIN);
    lv_obj_set_size(s_solarProdLbl, SC_W, 16);
    lv_obj_set_pos(s_solarProdLbl, rx, Y_CONT + 159);
    lv_label_set_text(s_solarProdLbl, "--");

    // ── Battery column ────────────────────────────────────────────────────
    // SOC % label — centered in battery column (moved 3px down)
    s_battSocLbl = lv_label_create(s_scr);
    lv_obj_set_style_text_font(s_battSocLbl, &lv_font_montserrat_14, LV_PART_MAIN);
    lv_obj_set_style_text_color(s_battSocLbl, lv_color_white(), LV_PART_MAIN);
    lv_obj_set_style_text_align(s_battSocLbl, LV_TEXT_ALIGN_CENTER, LV_PART_MAIN);
    lv_obj_set_size(s_battSocLbl, BC_W, 14);
    lv_obj_set_pos(s_battSocLbl, BC_X, Y_CONT + 93);
    lv_label_set_text(s_battSocLbl, "--");

    // Battery terminals (two nubs above body, left and right)
    auto makeBattNub = [&](int x) -> lv_obj_t* {
        lv_obj_t* n = lv_obj_create(s_scr);
        lv_obj_remove_style_all(n);
        lv_obj_set_size(n, 6, 6);
        lv_obj_set_pos(n, x, BB_Y - 5);
        lv_obj_set_style_bg_opa(n, LV_OPA_COVER, LV_PART_MAIN);
        lv_obj_set_style_bg_color(n, lv_color_hex(0x888888), LV_PART_MAIN);
        lv_obj_set_style_radius(n, 1, LV_PART_MAIN);
        lv_obj_clear_flag(n, (lv_obj_flag_t)LV_OBJ_FLAG_SCROLLABLE);
        return n;
    };
    s_battNub  = makeBattNub(BB_X + 6);               // left terminal
    s_battNub2 = makeBattNub(BB_X + BB_W - 6 - 6);   // right terminal

    s_battFillX = BB_X + 1;   // cached for cydUpdateBatt()

    // Battery body: border-only vertical rect 34×39 px
    s_battBody = lv_obj_create(s_scr);
    lv_obj_remove_style_all(s_battBody);
    lv_obj_set_size(s_battBody, BB_W, BB_H);
    lv_obj_set_pos(s_battBody, BB_X, BB_Y);
    lv_obj_set_style_bg_opa(s_battBody, LV_OPA_0, LV_PART_MAIN);
    lv_obj_set_style_border_color(s_battBody, lv_color_hex(0x888888), LV_PART_MAIN);
    lv_obj_set_style_border_width(s_battBody, 1, LV_PART_MAIN);
    lv_obj_set_style_radius(s_battBody, 2, LV_PART_MAIN);
    lv_obj_clear_flag(s_battBody, (lv_obj_flag_t)LV_OBJ_FLAG_SCROLLABLE);

    // Battery fill: bottom-anchored, height updated by cydUpdateBatt()
    s_battFill = lv_obj_create(s_scr);
    lv_obj_remove_style_all(s_battFill);
    lv_obj_set_size(s_battFill, BB_W - 2, 0);   // height = 0 until first update
    lv_obj_set_pos(s_battFill, BB_X + 1, BB_Y + 1 + BF_IH);  // starts at bottom
    lv_obj_set_style_bg_opa(s_battFill, LV_OPA_COVER, LV_PART_MAIN);
    lv_obj_set_style_bg_color(s_battFill, lv_color_hex(0x44bb44), LV_PART_MAIN);
    lv_obj_set_style_radius(s_battFill, 1, LV_PART_MAIN);
    lv_obj_clear_flag(s_battFill, (lv_obj_flag_t)LV_OBJ_FLAG_SCROLLABLE);

    // ── Energy dropdown — hidden on Combi D (no electrical option) ────────
    lv_obj_add_flag(makeSecLabel(s_scr, rx, Y_CONT + 108, t(TK::ENERGY)), LV_OBJ_FLAG_HIDDEN);

    s_energyDd = lv_dropdown_create(s_scr);
    lv_obj_set_pos(s_energyDd, rx, Y_CONT + 124);
    lv_obj_set_size(s_energyDd, rw, 28);
    lv_dropdown_set_options(s_energyDd,
        "Gas\n"
        "Gas + Elec. 850 W\n"
        "Gas + Elec. 1700 W\n"
        "Elec. 850 W\n"
        "Elec. 1700 W");
    lv_dropdown_set_selected(s_energyDd, (uint16_t)s_energyMode);

    lv_obj_set_style_bg_color(s_energyDd,     lv_color_hex(C_BTN_OFF), LV_PART_MAIN);
    lv_obj_set_style_text_color(s_energyDd,   lv_color_white(),         LV_PART_MAIN);
    lv_obj_set_style_border_color(s_energyDd, lv_color_hex(C_SEP),      LV_PART_MAIN);
    lv_obj_set_style_border_width(s_energyDd, 1,                         LV_PART_MAIN);
    lv_obj_set_style_text_font(s_energyDd,    &lv_font_montserrat_14,    LV_PART_MAIN);

    lv_obj_t* ddList = lv_dropdown_get_list(s_energyDd);
    lv_obj_set_style_bg_color(ddList,     lv_color_hex(C_BTN_OFF), LV_PART_MAIN);
    lv_obj_set_style_text_color(ddList,   lv_color_white(),         LV_PART_MAIN);
    lv_obj_set_style_border_color(ddList, lv_color_hex(C_SEP),      LV_PART_MAIN);
    lv_obj_set_style_text_font(ddList,    &lv_font_montserrat_14,    LV_PART_MAIN);

    lv_obj_add_event_cb(s_energyDd, energyDdCb, LV_EVENT_VALUE_CHANGED, nullptr);
    lv_obj_add_flag(s_energyDd, LV_OBJ_FLAG_HIDDEN);

    // ── Status bar ────────────────────────────────────────────────────────
    s_statusLbl = lv_label_create(s_scr);
    lv_obj_set_style_text_font(s_statusLbl, &lv_font_montserrat_14, LV_PART_MAIN);
    lv_obj_set_style_text_color(s_statusLbl, lv_color_hex(C_WIFI_OK), LV_PART_MAIN);
    lv_label_set_text(s_statusLbl, t(TK::STATUS_INIT));
    lv_obj_align(s_statusLbl, LV_ALIGN_BOTTOM_LEFT, 5, -18);

    s_ipLbl = lv_label_create(s_scr);
    lv_obj_set_style_text_font(s_ipLbl, &lv_font_montserrat_12, LV_PART_MAIN);
    lv_obj_set_style_text_color(s_ipLbl, lv_color_hex(0x88aaff), LV_PART_MAIN);
    lv_label_set_text(s_ipLbl, "");
    lv_obj_set_width(s_ipLbl, 310);
    lv_label_set_long_mode(s_ipLbl, LV_LABEL_LONG_DOT);
    lv_obj_align(s_ipLbl, LV_ALIGN_BOTTOM_LEFT, 5, -2);

    refreshControls();
    placeLogoInStatusBar(s_scr);
}

// ═══════════════════════════════════════════════════════════════════════════
// cydUpdateSolar — refresh solar data labels (call under LVGL mutex)
// ═══════════════════════════════════════════════════════════════════════════
static const char* solarStateName(uint8_t s) {
    bool es = (currentLanguage() == Language::ES);
    switch (s) {
        case   0: return es ? "Apagado"      : "Off";
        case   2: return es ? "Fallo"        : "Fault";
        case   3: return es ? "Carga inicial": "Bulk";
        case   4: return es ? "Absorcion"     : "Absorb";
        case   5: return es ? "Flotacion"     : "Float";
        case   7: return es ? "Ecualiz."     : "Equalize";
        case 245: return es ? "Iniciando"    : "Starting";
        case 247: return es ? "Auto-ec."     : "Auto-eq";
        case 252: return es ? "Ctrl. ext."   : "Ext ctrl";
        default:  return "?";
    }
}

void cydUpdateSolar(const CydSolarData& d) {
    if (!s_solarStateLbl) return;

    char buf[40];

    if (!d.configured) {
        lv_label_set_text(s_solarStateLbl, t(TK::SOLAR_NO_DATA));
        lv_label_set_text(s_solarVoltLbl,  "");
        lv_label_set_text(s_solarLoadLbl,  "");
        lv_label_set_text(s_solarProdLbl,  "");
        return;
    }

    // Stale data after 2 minutes → show "--"
    bool fresh = d.valid && d.ageMs < 120000;

    if (!fresh) {
        lv_label_set_text(s_solarStateLbl, "--");
        lv_label_set_text(s_solarVoltLbl,  "--");
        lv_label_set_text(s_solarLoadLbl,  "--");
        lv_label_set_text(s_solarProdLbl,  "--");
        return;
    }

    // State line: "Bulk" (+ " E01" if error)
    if (d.errCode != 0) {
        snprintf(buf, sizeof(buf), "%s E%02d", solarStateName(d.state), d.errCode);
    } else {
        snprintf(buf, sizeof(buf), "%s", solarStateName(d.state));
    }
    lv_label_set_text(s_solarStateLbl, buf);

    // Voltage line: "Volt.: 12.6V"
    snprintf(buf, sizeof(buf), "%s %.1fV", t(TK::SOLAR_VOLT), d.battV);
    lv_label_set_text(s_solarVoltLbl, buf);

    // Load line: "Carga: 5.2A / 35W"
    snprintf(buf, sizeof(buf), "%s %.1fA / %.0fW", t(TK::SOLAR_LOAD), d.battA, d.pvW);
    lv_label_set_text(s_solarLoadLbl, buf);

    // Production line: "Prod.: 1.45kWh"
    snprintf(buf, sizeof(buf), "%s %.2fkWh", t(TK::SOLAR_PROD), d.kWhToday);
    lv_label_set_text(s_solarProdLbl, buf);
}

// ═══════════════════════════════════════════════════════════════════════════
// cydUpdateBatt — refresh battery SOC widget (call under LVGL mutex)
// ═══════════════════════════════════════════════════════════════════════════
void cydUpdateBatt(const CydBattData& d) {
    if (!s_battSocLbl) return;

    // These must match the static constants in buildMainUI()
    static const int BB_Y  = Y_CONT + 118;
    static const int BF_IH = 45;   // fill inner height

    bool fresh = d.configured && d.valid && d.ageMs < 120000;

    if (!fresh) {
        lv_label_set_text(s_battSocLbl, "--");
        lv_obj_set_height(s_battFill, 0);
        return;
    }

    char buf[8];
    snprintf(buf, sizeof(buf), "%d%%", d.soc);
    lv_label_set_text(s_battSocLbl, buf);

    // Fill is bottom-anchored: taller = more charge
    int fillH = (int)d.soc * BF_IH / 100;
    if (fillH < 0)    fillH = 0;
    if (fillH > BF_IH) fillH = BF_IH;
    lv_obj_set_size(s_battFill, 32, fillH);   // 32 = body width (34) - 2 borders
    lv_obj_set_pos(s_battFill, s_battFillX,
                               BB_Y + 1 + (BF_IH - fillH));

    // Color: green ≥50%, amber 20–49%, red <20% — only fill changes color
    uint32_t color = (d.soc >= 50) ? 0x44bb44u
                   : (d.soc >= 20) ? 0xffbb00u
                                   : 0xff3333u;
    lv_obj_set_style_bg_color(s_battFill, lv_color_hex(color), LV_PART_MAIN);
}

// ═══════════════════════════════════════════════════════════════════════════
// updateWaterTempWidget — refresh water temperature bar (call under LVGL mutex)
// ═══════════════════════════════════════════════════════════════════════════
static void updateWaterTempWidget(float temp, bool heating) {
    if (!s_waterTempLbl) return;
    static const int WB_Y  = Y_CONT + 26;
    static const int WF_IH = 52;   // 54 - 2
    static const float WTEMP_SCALE = 70.0f;   // 0..70 °C bar range

    if (temp < 0.0f || temp > 100.0f) {
        lv_label_set_text(s_waterTempLbl, "--");
        lv_obj_set_height(s_waterTempFill, 0);
        lv_obj_set_style_border_color(s_waterTempBody, lv_color_hex(0x888888), LV_PART_MAIN);
        return;
    }

    char buf[12];
    snprintf(buf, sizeof(buf), "%.0f°C", temp);
    lv_label_set_text(s_waterTempLbl, buf);

    // Bar fill — proportional to 0..70 °C, bottom-anchored. Fixed scale
    // independent of boiler state so the bar reads the same temperature
    // whether the boiler is on or off (matches the web widget).
    int fillH = (int)(temp * WF_IH / WTEMP_SCALE);
    if (fillH < 0) fillH = 0;
    if (fillH > WF_IH) fillH = WF_IH;
    lv_obj_set_size(s_waterTempFill, 28, fillH);  // 28 = 30 - 2
    lv_obj_set_pos(s_waterTempFill, s_waterTempFillX,
                   WB_Y + 1 + (WF_IH - fillH));

    // Absolute colour thresholds: blue <30 °C, amber 30-51 °C, red ≥51 °C.
    // The body stays static while heating — only the topbar drop icon
    // (s_aguaLbl) pulses to signal demand.
    uint32_t color = (temp < 30.0f) ? 0x4488ffu
                   : (temp < 51.0f) ? 0xffbb00u
                                    : 0xff3333u;
    lv_obj_set_style_border_color(s_waterTempBody, lv_color_hex(0x888888), LV_PART_MAIN);
    lv_obj_set_style_bg_opa(s_waterTempFill, LV_OPA_COVER, LV_PART_MAIN);
    lv_obj_set_style_bg_color(s_waterTempFill, lv_color_hex(color), LV_PART_MAIN);
    (void)heating;   // kept in the signature to avoid touching the API
}

// ═══════════════════════════════════════════════════════════════════════════
// cydRebuildUI — tear down and recreate all main-screen widgets
// ═══════════════════════════════════════════════════════════════════════════
void cydRebuildUI() {
    if (!s_scr) return;
    // Null out error modal handle before lv_obj_clean deletes it
    s_errorModal   = nullptr;
    s_lastErrClass = 0;
    s_lastErrCode  = 0;
    s_errAcked     = false;
    // Null widget handles (pointers become dangling after lv_obj_clean)
    s_ambLbl = s_aguaLbl = s_fireLbl = s_extLbl = nullptr;
    s_wifiDot = s_linDot = nullptr;
    s_heatBtn = s_heatBtnLbl = nullptr;
    s_spRow = s_spLbl = nullptr;
    s_fanHeatingRow = s_fanOffRow = s_fanLevelRow = nullptr;
    for (int i = 0; i < FAN_N;    i++) s_fanBtn[i]    = nullptr;
    for (int i = 0; i < BOILER_N; i++) s_boilerBtn[i] = nullptr;
    s_fanOnBtn = s_fanOffBtn = s_fanLevelLbl = nullptr;
    s_energyDd = s_statusLbl = s_ipLbl = nullptr;
    s_solarStateLbl = s_solarVoltLbl = s_solarLoadLbl = s_solarProdLbl = nullptr;
    s_battSocLbl = s_battBody = s_battFill = s_battNub = s_battNub2 = nullptr;
    s_waterTempLbl = s_waterTempBody = s_waterTempFill = nullptr;
    lv_obj_clean(s_scr);   // delete all children
    buildMainUI();
}

// ═══════════════════════════════════════════════════════════════════════════
// cydFreeMainUI — free all main-screen widgets without rebuilding.
// Call before entering a blocking setup screen that needs LVGL heap room
// (the keyboard widget alone is ~16 KB). Follow with cydRebuildUI() on exit.
// Must be called under the LVGL mutex.
// ═══════════════════════════════════════════════════════════════════════════
void cydFreeMainUI() {
    if (!s_scr) return;
    s_errorModal   = nullptr;
    s_lastErrClass = 0;
    s_lastErrCode  = 0;
    s_errAcked     = false;
    s_ambLbl = s_aguaLbl = s_fireLbl = s_extLbl = nullptr;
    s_wifiDot = s_linDot = nullptr;
    s_heatBtn = s_heatBtnLbl = nullptr;
    s_spRow = s_spLbl = nullptr;
    s_fanHeatingRow = s_fanOffRow = s_fanLevelRow = nullptr;
    for (int i = 0; i < FAN_N;    i++) s_fanBtn[i]    = nullptr;
    for (int i = 0; i < BOILER_N; i++) s_boilerBtn[i] = nullptr;
    s_fanOnBtn = s_fanOffBtn = s_fanLevelLbl = nullptr;
    s_energyDd = s_statusLbl = s_ipLbl = nullptr;
    s_solarStateLbl = s_solarVoltLbl = s_solarLoadLbl = s_solarProdLbl = nullptr;
    s_battSocLbl = s_battBody = s_battFill = s_battNub = s_battNub2 = nullptr;
    s_waterTempLbl = s_waterTempBody = s_waterTempFill = nullptr;
    lv_obj_clean(s_scr);
}

// ═══════════════════════════════════════════════════════════════════════════
// cydDisplayInit
// ═══════════════════════════════════════════════════════════════════════════
void cydDisplayInit(TTempSetting*   roomSetpoint,
                    TBoilerSetting* waterSetpoint,
                    TOnOffSetting*  heatingOn,
                    TFanSetting*    fanMode) {
    s_roomSp  = roomSetpoint;
    s_waterSp = waterSetpoint;
    s_heatOn  = heatingOn;
    s_fanMode = fanMode;

    loadTimeoutIdx();
    loadLanguage();

    // Force full backlight from the very start. smartdisplay_init() leaves
    // the LEDC channel at its default duty (~50%), and our fade task only
    // calls set_backlight() when s_blCurrent != s_blTarget — both are 1.0f
    // by initialisation, so without this explicit call the splash, language
    // selector and main UI all render at half brightness until the first
    // screen-timeout wake cycle re-syncs them.
    smartdisplay_lcd_set_backlight(1.0f);

    showSplash(2000);

    // Language selection on first boot (no language stored in NVS yet)
    if (!isLanguageSet()) showLangSelectBlocking();

    // ── Main screen ──────────────────────────────────────────────────────
    s_scr = lv_obj_create(NULL);
    lv_obj_remove_style_all(s_scr);
    lv_obj_set_style_bg_color(s_scr, lv_color_hex(C_BG), LV_PART_MAIN);
    lv_obj_set_style_bg_opa(s_scr, LV_OPA_COVER, LV_PART_MAIN);
    lv_obj_clear_flag(s_scr, (lv_obj_flag_t)LV_OBJ_FLAG_SCROLLABLE);

    buildMainUI();          // populate before loading to avoid blank-screen flash
    lv_screen_load(s_scr);

    lv_mem_monitor_t mon;
    lv_mem_monitor(&mon);
    LOG_MEM_PF("[lvgl] pool used=%u/%u free=%u frag=%u%%\n",
        (unsigned)mon.total_size - mon.free_size,
        (unsigned)mon.total_size,
        (unsigned)mon.free_size,
        (unsigned)mon.frag_pct);

    // Backlight fade task (Core 1, low priority)
    // ESP32-C5 is single-core: pinning to core 1 trips an assert in FreeRTOS.
    #ifdef CYD_C5
    xTaskCreate(backlightTask, "bckl", 1536, nullptr, 1, nullptr);
    #else
    xTaskCreatePinnedToCore(backlightTask, "bckl", 1536, nullptr, 1, nullptr, 1);
    #endif
}

// ═══════════════════════════════════════════════════════════════════════════
// cydDisplayUpdate  — called every loop() iteration
// ═══════════════════════════════════════════════════════════════════════════
void cydDisplayUpdate(bool wifiok, bool trumaok,
                      bool truma_reset, bool inota,
                      float roomTemp, float waterTemp, bool waterHeating,
                      float extTemp, uint8_t errClass, uint8_t errCode,
                      bool burnerFiring) {

    // ── Auto screen-off ─────────────────────────────────────────────────
    // Three stages: 100% → 30% dim warning (5 s before) → off.
    // Any touch resets lv_display_get_inactive_time(), which undoes the dim.
    {
        uint32_t to       = TIMEOUT_MS[s_timeoutIdx];
        uint32_t inactive = lv_display_get_inactive_time(NULL);

        if (to > 0 && !s_screenOff) {
            if (inactive >= to) {
                blFadeTo(0.0f);
                s_screenOff    = true;
                s_screenDimmed = false;
                if (!s_wakeOverlay) {
                    // Transparent overlay on lv_layer_top — captures the first
                    // touch and re-lights the screen without activating controls below.
                    s_wakeOverlay = lv_obj_create(lv_layer_top());
                    lv_obj_remove_style_all(s_wakeOverlay);
                    lv_obj_set_size(s_wakeOverlay, 320, 240);
                    lv_obj_set_pos(s_wakeOverlay, 0, 0);
                    lv_obj_set_style_bg_opa(s_wakeOverlay, LV_OPA_TRANSP, LV_PART_MAIN);
                    lv_obj_add_event_cb(s_wakeOverlay, wakeCb, LV_EVENT_PRESSED, nullptr);
                }
            } else if (inactive + 5000 >= to) {
                if (!s_screenDimmed) { blFadeTo(0.3f); s_screenDimmed = true; }
            } else {
                if (s_screenDimmed) { blFadeTo(1.0f); s_screenDimmed = false; }
            }
        }
    }

    // ── Tint (boiler/water) and fire (heating) indicators ────────────────
    //
    // Mutual-exclusion rule (mirrors the real Truma Combi behaviour):
    // the single physical burner can either be heating the air or
    // priority-heating the water, never both at once.  Heating always
    // takes priority — water heats only as a side-effect — EXCEPT when
    // the boiler is in 60 °C "boost" mode, which explicitly pauses
    // heating to maximise hot-water throughput.
    //
    //   burner firing + boost mode          → water blinks, fire solid
    //   burner firing + heating demand      → fire blinks,  water solid
    //   burner firing + only water demand   → water blinks, fire solid/off
    //   burner not firing                   → neither blinks
    {
        bool blinkPhase = (millis() % 1000) < 500;

        bool   boilerOn   = s_waterSp && (s_waterSp->getStringValue() != "off");
        bool   isBoost    = s_waterSp && (s_waterSp->getStringValue() == "boost");
        double wSetpoint  = s_waterSp ? s_waterSp->getFloatValue() : 0.0;
        // Cooldown override: water_heating flag may stay set after the
        // burner stops; temperature is authoritative for "reached".
        bool   wAtTemp    = boilerOn && (waterTemp > 0.0f) && ((double)waterTemp >= wSetpoint - 1.0);

        bool   heatOn     = s_heatOn && (s_heatOn->getIntValue() != 0);
        float  rSetpoint  = (s_roomSp && heatOn) ? s_roomSp->getFloatValue() : 0.0f;
        bool   heatDemand = heatOn && trumaok && (roomTemp > -200.0f) && (roomTemp < rSetpoint - 0.3f);

        // burnerFiring is the raw frame 0x22 water_heating bit passed in
        // by the caller — independent of WaterSetpoint, so it stays true
        // even when the boiler is "off" but the burner is firing for air.

        // Decide which icon (if any) gets the blink this cycle.
        bool waterBlinks = burnerFiring && boilerOn && !wAtTemp && ( isBoost || !heatDemand );
        bool fireBlinks  = burnerFiring && heatDemand && !isBoost;

        if (s_aguaLbl) {
            lv_color_t c;
            lv_opa_t   opa;
            if (!boilerOn)        { c = lv_color_hex(0xaaccff); opa = LV_OPA_20; }    // off: dim blue
            else if (!waterBlinks){ c = lv_color_hex(0xaaccff); opa = LV_OPA_COVER; } // at temp / not our turn: solid blue
            else if (blinkPhase)  { c = lv_color_hex(0xaaccff); opa = LV_OPA_COVER; } // boost / water-only firing: visible phase
            else                  { c = lv_color_hex(C_TOPBAR); opa = LV_OPA_COVER; } // ...dark phase
            lv_obj_set_style_text_color(s_aguaLbl, c, LV_PART_MAIN);
            lv_obj_set_style_text_opa(s_aguaLbl, opa, LV_PART_MAIN);
        }
        if (s_fireLbl) {
            lv_color_t c;
            lv_opa_t   opa;
            if (!heatOn)          { c = lv_color_hex(0xaaccff); opa = LV_OPA_20; }    // off: dim blue
            else if (!fireBlinks) { c = lv_color_hex(0xff8844); opa = LV_OPA_COVER; } // at temp / boost / burner paused: solid orange
            else if (blinkPhase)  { c = lv_color_hex(0xff8844); opa = LV_OPA_COVER; } // heating: visible phase
            else                  { c = lv_color_hex(C_TOPBAR); opa = LV_OPA_COVER; } // heating: dark phase
            lv_obj_set_style_text_color(s_fireLbl, c, LV_PART_MAIN);
            lv_obj_set_style_text_opa(s_fireLbl, opa, LV_PART_MAIN);
        }
    }

    // ── Indoor temperature label ─────────────────────────────────────────
    if (s_ambLbl) {
        char buf[32];
        if (trumaok && roomTemp > -200.0f)
            snprintf(buf, sizeof(buf), MY_SYMBOL_THERMOMETER " %.1f \xc2\xb0""C", roomTemp);
        else
            strcpy(buf, MY_SYMBOL_THERMOMETER " -- \xc2\xb0""C");
        lv_label_set_text(s_ambLbl, buf);
    }

    // ── Outdoor temperature (AM2301) ─────────────────────────────────────
    if (s_extLbl) {
        char buf[28];
        if (extTemp > -200.0f)
            snprintf(buf, sizeof(buf), MY_SYMBOL_THERM_EXT " " MY_SYMBOL_CHEVRON_R " %.1f\xc2\xb0""C", extTemp);
        else
            strcpy(buf, MY_SYMBOL_THERM_EXT " " MY_SYMBOL_CHEVRON_R " --\xc2\xb0""C");
        lv_label_set_text(s_extLbl, buf);
    }

    // ── Water temperature widget ─────────────────────────────────────────
    updateWaterTempWidget(waterTemp, waterHeating);

    // ── WiFi icon ────────────────────────────────────────────────────────
    static bool s_everConnected = false;
    static bool s_lastWifiOk = false;
    if (wifiok != s_lastWifiOk) {
        s_lastWifiOk = wifiok;
        LOG_WIFI_PF("[wifi] wifiok changed: %s  heap=%u\n",
                      wifiok ? "true" : "false", ESP.getFreeHeap());
    }
    if (wifiok) s_everConnected = true;
    if (s_wifiDot) {
        lv_color_t c = lv_color_hex(wifiok          ? C_WIFI_OK   :
                                     s_everConnected ? C_WIFI_NO   :
                                                       C_WIFI_CONN);
        lv_obj_set_style_text_color(s_wifiDot, c, LV_PART_MAIN);
    }

    // ── LIN bus icon ─────────────────────────────────────────────────────
    if (s_linDot)
        lv_obj_set_style_text_color(s_linDot,
            lv_color_hex(trumaok ? C_WIFI_OK : C_WIFI_NO), LV_PART_MAIN);

    // ── SSID / IP address ────────────────────────────────────────────────
    if (s_ipLbl) {
        if (wifiok) {
            char buf[64];
            snprintf(buf, sizeof(buf), "%s / %s", WiFi.SSID().c_str(), WiFi.localIP().toString().c_str());
            lv_label_set_text(s_ipLbl, buf);
        } else {
            lv_label_set_text(s_ipLbl, "");
        }
    }

    // ── Status message ───────────────────────────────────────────────────
    static char s_errBuf[48];
    const char* msg  = "";
    uint32_t    msgC = C_WIFI_OK;

    if (inota) {
        msg = t(TK::STATUS_OTA);          msgC = 0xffd700;
    } else if (!wifiok) {
        auto ws = WiFi.status();
        if (ws == WL_DISCONNECTED || ws == WL_IDLE_STATUS) {
            msg = t(TK::STATUS_WIFI_CONN); msgC = C_WIFI_CONN;
        } else {
            msg = t(TK::STATUS_NO_WIFI);   msgC = C_WIFI_NO;
        }
    } else if (!trumaok) {
        // prepend a warning symbol; snprintf into the shared error buffer
        snprintf(s_errBuf, sizeof(s_errBuf), "%s %s", LV_SYMBOL_WARNING, t(TK::STATUS_NO_LIN));
        msg  = s_errBuf;
        msgC = C_WIFI_NO;
    } else if (errCode != 0) {
        TK errLblKey;
        if (errClass == 1 || errClass == 2) { errLblKey = TK::WARN_LBL;   msgC = C_WARN;       }
        else if (errClass == 40)             { errLblKey = TK::LOCKED_LBL; msgC = C_ERR_LOCKED; }
        else                                 { errLblKey = TK::ERROR_LBL;  msgC = C_WIFI_NO;    }
        snprintf(s_errBuf, sizeof(s_errBuf), "%s %s  Cl.%02Xh/Cod.%d",
                 LV_SYMBOL_WARNING, t(errLblKey), errClass, errCode);
        msg = s_errBuf;
    }

    if (s_statusLbl) {
        lv_label_set_text(s_statusLbl, msg);
        lv_obj_set_style_text_color(s_statusLbl, lv_color_hex(msgC), LV_PART_MAIN);
    }

    // ── Truma error modal ────────────────────────────────────────────────
    if (errClass != s_lastErrClass || errCode != s_lastErrCode) {
        s_lastErrClass = errClass;
        s_lastErrCode  = errCode;
        s_errAcked     = false;
        if (s_errorModal) { lv_obj_delete(s_errorModal); s_errorModal = nullptr; }
    }
    if (errCode != 0 && !s_errAcked && !s_errorModal) showErrorModal(errClass, errCode);

    // ── Re-sync controls (may have changed via external MQTT/WS) ─────────
    refreshControls();
}

#endif // CYD
